// HU058NtpClock - Andrew Frelas
// NTP clock firmware for the HU-058 / HU-058SE "IoT Colorful" clock kit (STC8G1K17 + DS1302
// board), with an ESP32-C3 SuperMini in place of the STC8G1K17 driving both AiP33628 matrix
// drivers directly. Time, time zone, daylight saving, colours, effects and settings run on the
// SuperMini and are controlled from its own web page. No external libraries.
//
// Timekeeping, Wi-Fi, settings storage and the web plumbing follow NtpClockMod (the 4-in-1
// clock mod on the same SuperMini). Panel protocol and LED map: misterblack1,
// https://github.com/misterblack1/HU-058_ESPHome (docs/display-map.md, docs/aip33628-protocol.md)
//
// Target : ESP32-C3 SuperMini, Arduino IDE 2.x, Espressif "esp32" core 3.3.x
// Board  : Tools > Board > esp32 > "Nologo ESP32C3 Super Mini"
//          Tools > USB CDC On Boot: Enabled        (serial log over the C3's native USB)
//          Tools > Partition Scheme: "Default 4MB with spiffs (1.2MB APP/1.5MB SPIFFS)"
//          Not "Huge APP" or any "No OTA" scheme: those remove firmware updates over Wi-Fi.
// Web UI : http://hu058clock.local/
//
// Wiring (SuperMini -> clock board MCU footprint, DIP-16). Fit SW1, SW2, USB1, C3, C4 only.
//   GPIO4  -> DIP pin 16   CLK,    driver 1 (pin 14 is the DS1302 RST line on this board)
//   GPIO5  -> DIP pin 5    DATA,   driver 1
//   GPIO6  -> DIP pin 1    CLK_1,  driver 2
//   GPIO7  -> DIP pin 2    DATA_1, driver 2
//   GPIO3  -> DIP pin 9    S1, top button (SW2 on the board)
//   GPIO10 -> DIP pin 10   S2, bottom button (SW1 on the board)
//   5V     -> DIP pin 6    +5V (VCC)
//   GND    -> DIP pin 8
//   Never power from the clock's USB and the SuperMini's USB-C at the same time.
//
// Buttons: S1 tap = brightness step, S1 hold = display on/off, S2 tap = next effect,
//          S2 hold = show IP address, both held 10 s = factory reset (Wi-Fi is kept).

// ============================================================================ CONFIGURATION

#define FW_VERSION              "01.02.03"

// ---- Wi-Fi and name
// Real Wi-Fi details here are used, and saved on the clock once it has joined with them. Left as
// the placeholders, the clock uses the network it saved. Firmware before 01.02.02 saved nothing,
// so the first update of such a clock must be built with real details. The Network tab shows
// whether a clock has its network saved.
#define WIFI_SSID               "your-ssid"
#define WIFI_PASSWORD           "your-password"
// First-boot default only. After that the name is set on the Network tab and kept through
// firmware updates; a factory reset returns to this. 1..31 of a-z, 0-9 and '-'.
#define DEVICE_HOSTNAME         "hu058clock"        // web UI: http://hu058clock.local/
#define FALLBACK_HOSTNAME       "hu058clock"        // used if DEVICE_HOSTNAME is not a valid name

// Reconnect policy: the device retries for as long as it is powered, forever.
#define WIFI_RETRY_MIN_MS       5000UL              // first retry delay after a drop
#define WIFI_RETRY_MAX_MS       60000UL             // retry delay ceiling
#define WIFI_RADIO_RESET_TRIES  12                  // failed tries before the radio is restarted

// Transmit power. Every converging report on the C3 SuperMini running hot points at the radio,
// not the core: a no-WiFi build stays cool, cutting TX power fixed it outright for one user,
// and a thermal camera showed 60 C -> 40 C from allowing modem sleep.
// esp_wifi_set_max_tx_power takes 0.25 dBm units, range [8, 84] = 2 to 20 dBm, and QUANTISES
// to 2, 5, 7, 8, 11, 13, 14, 15, 16, 18, 20 dBm; anything between rounds DOWN.
// Must be re-applied after every STA start - a radio reset puts it back to the default.
#define WIFI_TX_DBM_DEFAULT     11

// Modem sleep: 0 = none, 1 = min modem, 2 = max modem. Off by default: it slows the web page.
#define WIFI_PS_MODE_DEFAULT    0

// ---- Passwords: first-boot defaults only. After that they are set on the Network tab and kept
// through firmware updates; a factory reset (both buttons, 10 s) returns to these. Firmware
// before 01.02.03 kept them only in its compiled code: if a clock's earlier build set any, build
// its first 01.02.03 image with the same values, or they are replaced by the ones below.
// Optional web UI login. Empty user = no authentication (LAN only).
#define WEB_AUTH_USER           ""
#define WEB_AUTH_PASS           ""
// Arduino IDE network upload (ArduinoOTA). Empty = no password.
#define OTA_PASSWORD            ""

// ---- Time defaults (first boot only; all editable in the web UI)
// lwIP is given exactly ONE server at a time; the failover policy lives in ntpPolicy().
#define DEFAULT_NTP_SERVER      "time.chu.nrc.ca"
#define DEFAULT_NTP_SERVER2     "time.nrc.ca"       // empty string = slot unused
#define DEFAULT_NTP_SERVER3     ""
#define NTP_SERVER_SLOTS        3

// Failover policy. A server that has not answered within NTP_PROBE_S of being selected is passed
// over. One that has answered is judged on ongoing silence over NTP_FAILOVER_AFTER_MULT poll
// intervals floored at NTP_FAILOVER_MIN_S. While on a fallback the primary is retried every
// NTP_RETURN_PRIMARY_S and keeps the slot if it answers.
#define NTP_FAILOVER_DEFAULT    true
#define NTP_FAILOVER_AFTER_MULT 2
#define NTP_FAILOVER_MIN_S      90UL
#define NTP_RETURN_PRIMARY_S    1800UL
#define NTP_PROBE_S             60UL

// How often ntpPolicy() does real work. Anything called from loop() must not take a lock on its
// common path; the policy bails on a plain millis() comparison first.
#define NTP_POLICY_PERIOD_MS    1000UL
#define DEFAULT_TZ              "EST5EDT,M3.2.0,M11.1.0"   // POSIX rule, America/Toronto
#define DEFAULT_SYNC_INTERVAL_S 60                  // NTP poll interval, seconds
#define DEFAULT_DST_MODE        0                   // 0 = follow zone rule, 1 = standard only, 2 = daylight only

// Crystal drift: two-point estimate, NTP time elapsed against esp_timer elapsed from a baseline
// taken at the first sync. Noise floor is 2 * jitter / span; quoted once the span is long enough.
#define DRIFT_PPM_LIMIT         250.0f    // discard any estimate outside +/- this: bad data
#define DRIFT_VALID_SPAN_S      3600UL    // baseline before the figure is trusted
#define DRIFT_SYNC_JITTER_US    10000.0f  // assumed per-endpoint sync jitter, for the error bar
#define DRIFT_RECENT_MIN_SPAN_S 1800UL    // shortest window for the recent-rate diagnostic

#define NTP_MIN_INTERVAL_S      15UL      // RFC 4330 floor
#define NTP_MAX_INTERVAL_S      86400UL

// Sync health for the optional colon status dot: link up and a sync within this many poll
// intervals, floored at NTP_HEALTH_MIN_S.
#define NTP_HEALTH_MULT         3UL
#define NTP_HEALTH_MIN_S        3600UL

// ---- Wiring: ESP32-C3 SuperMini GPIO -> HU-058 MCU footprint (DIP-16) pin
// All four display lines must be GPIO0..21 (single output register on the C3). Avoid GPIO2, 8 and
// 9 (strapping; GPIO8 is also the SuperMini's blue LED, GPIO9 its BOOT button) and GPIO18/19
// (native USB). GPIO20/21 are UART0, which the ROM bootloader talks on at reset.
#define PIN_CLK                 4   // DIP pin 16, driver 1 clock
#define PIN_DATA                5   // DIP pin 5,  driver 1 data
#define PIN_CLK_1               6   // DIP pin 1,  driver 2 clock
#define PIN_DATA_1              7   // DIP pin 2,  driver 2 data
#define PIN_BTN_1               3   // DIP pin 9,  S1, top button, SW2 on the board (switch to GND)
#define PIN_BTN_2               10  // DIP pin 10, S2, bottom button, SW1 on the board (switch to GND)

// ---- Display defaults (first boot only)
#define DEFAULT_LIGHT_ON        true
#define DEFAULT_BRIGHTNESS      50                  // percent, 1..100
#define DEFAULT_COLOR_R         255
#define DEFAULT_COLOR_G         255
#define DEFAULT_COLOR_B         255
#define DEFAULT_TWELVE_HOUR     true                // true = 12 hour, false = 24 hour
#define DEFAULT_BLINK_COLON     true
#define DEFAULT_LEADING_ZERO    false
#define DEFAULT_COLON_STATUS    false               // true = upper colon dot shows sync health

// Ceiling on the driver current step IS[3:0], 0..15 (2.5 mA .. 40.4 mA per lit sink). Fixed and
// never derived from what is on screen. The board is labelled 250 mA; a lit white digit at 15
// draws about 400 mA and full white about 1.2 A. Lower it if the drivers run hotter than you want.
#define DEFAULT_MAX_CURRENT     12
#define LAMP_TEST_BRIGHTNESS    50                  // percent, still capped by max current

// ---- Buttons
#define BTN_DEBOUNCE_MS         25UL
#define BTN_LONG_MS             1000UL
#define BTN_COMBO_SHOW_MS       2000UL              // both held this long: reset countdown shows
#define BTN_FACTORY_RESET_MS    10000UL             // both held this long: factory reset
#define BTN_FEEDBACK_MS         1200UL
#define BRIGHTNESS_STEPS_LIST   5, 15, 30, 50, 75, 100   // S1 short press cycles these (percent)

// ---- Timing
#define SETTINGS_SAVE_DELAY_MS  5000UL              // display settings: NVS write this long after the last change
#define DISPLAY_PERIOD_MS       100UL               // face housekeeping cadence; the time itself redraws on the second
#define EFFECT_PERIOD_MS        40UL                // effect animation cadence, 25 Hz
#define TEMP_MODE_MIN_MS        100UL
#define TEMP_MODE_MAX_MS        600000UL
#define ACTION_SHOW_MS          5000UL              // web page "show" actions without a duration
#define LAMP_TEST_MS            3000UL
#define TEXT_SHOW_MAX_MS        60000UL
#define IP_SHOW_HEAD_MS         1000                // " IP " frame before the address
#define IP_SHOW_OCTET_MS        1300                // each number of the address
#define NO_NET_SHOW_MS          1200                // each frame of "no nEt"
#define RESTART_DELAY_MS        1500UL              // reply first, then restart
#define RESET_SHOW_MS           5000UL              // "rSt" on the face before a button factory reset
#define RESET_SHOW_HOLD_MS      500UL               // time it is shown before the restart
#define COUNTDOWN_FRAME_MS      1500UL              // each frame of the reset countdown
#define FRAME_CANCEL_MS         100UL               // blank frame that ends a cancelled countdown
#define JSON_RESERVE            3072                // bytes reserved for a status or settings reply
#define OTA_LOG_STEP_BYTES      131072UL            // serial progress line every 128 KB of an upload
#define WIFI_RADIO_OFF_MS       100UL               // radio held off during a radio restart
#define RESTART_FLUSH_MS        100UL               // serial drains before ESP.restart()
#define LOAD_RATE_PERIOD_MS     1000UL              // interrupts-per-second figure
#define LOOP_MAX_WINDOW_MS      10000UL             // longest-loop-pass window
#define HEARTBEAT_PERIOD_MS     5000UL              // serial [hb] line
#define LOOP_IDLE_MS            2UL                 // end of every loop pass (NtpClockMod)

// ---- Display bus
// The AiP33628 needs 16 ns of CLK high and low. These NOPs pad every edge to about 50 ns at
// 160 MHz on top of the GPIO store itself, a 3x margin with 3.3 V drive into a 5 V part.
#define BUS_EDGE_NOPS           8

// ============================================================================ INCLUDES

#include <Arduino.h>
#include <ArduinoOTA.h>
#include <ESPmDNS.h>
#include <Preferences.h>
#include <Update.h>
#include <WebServer.h>
#include <WiFi.h>

#include <cmath>
#include <cstddef>
#include <cstdint>
#include <cstdio>
#include <cstdlib>
#include <cstring>
#include <ctime>
#include <sys/time.h>

#include "driver/gptimer.h"
#include "esp_attr.h"
#include "esp_heap_caps.h"
#include "esp_ota_ops.h"
#include "esp_sntp.h"
#include "esp_system.h"
#include "esp_timer.h"
#include "esp_wifi.h"
#include "freertos/FreeRTOS.h"
#include "freertos/semphr.h"
#include "soc/gpio_reg.h"

#if !defined(CONFIG_IDF_TARGET_ESP32C3)
#error "This sketch targets the ESP32-C3. Select Tools > Board > Nologo ESP32C3 Super Mini."
#endif

static_assert(PIN_CLK <= 21 && PIN_DATA <= 21 && PIN_CLK_1 <= 21 && PIN_DATA_1 <= 21,
              "Display pins must be GPIO0..21 on the ESP32-C3");
static_assert(PIN_CLK != PIN_DATA && PIN_CLK != PIN_CLK_1 && PIN_CLK != PIN_DATA_1 &&
              PIN_DATA != PIN_CLK_1 && PIN_DATA != PIN_DATA_1 && PIN_CLK_1 != PIN_DATA_1,
              "Display pins must be distinct");
static_assert(sizeof(WIFI_SSID) <= 33, "WIFI_SSID is at most 32 characters");
static_assert(sizeof(WIFI_PASSWORD) <= 65, "WIFI_PASSWORD is at most 64 characters");
static_assert(sizeof(WEB_AUTH_USER) <= 33 && sizeof(WEB_AUTH_PASS) <= 65 && sizeof(OTA_PASSWORD) <= 65,
              "Web user is at most 32 characters, passwords at most 64");
static_assert(TEXT_SHOW_MAX_MS <= 65535 && COUNTDOWN_FRAME_MS <= 65535 && RESET_SHOW_MS <= 65535,
              "Face frame durations are 16-bit milliseconds");
static_assert(DEFAULT_MAX_CURRENT >= 0 && DEFAULT_MAX_CURRENT <= 15, "Max current is 0..15");

// ============================================================================ PURE LOGIC

namespace util {

void copyStr(char* dst, size_t n, const char* src) {
  if (n == 0) return;
  std::strncpy(dst, src ? src : "", n - 1);
  dst[n - 1] = '\0';
}

int hexNibble(char c) {
  if (c >= '0' && c <= '9') return c - '0';
  if (c >= 'a' && c <= 'f') return c - 'a' + 10;
  if (c >= 'A' && c <= 'F') return c - 'A' + 10;
  return -1;
}

// "RRGGBB" or "#RRGGBB" -> rgb. False on anything else.
bool parseHex(const char* s, uint8_t out[3]) {
  if (!s) return false;
  if (*s == '#') ++s;
  if (std::strlen(s) != 6) return false;
  for (int i = 0; i < 3; ++i) {
    const int hi = hexNibble(s[i * 2]), lo = hexNibble(s[i * 2 + 1]);
    if (hi < 0 || lo < 0) return false;
    out[i] = (uint8_t)(hi * 16 + lo);
  }
  return true;
}

void toHex(const uint8_t rgb[3], char out[8]) {
  std::snprintf(out, 8, "#%02x%02x%02x", rgb[0], rgb[1], rgb[2]);
}

// Strict integer parse: optional sign, digits only, whole string, inside [lo, hi].
bool parseLong(const char* s, long lo, long hi, long& out) {
  if (!s || !*s) return false;
  char* end = nullptr;
  const long v = std::strtol(s, &end, 10);
  if (!end || *end != '\0') return false;
  if (v < lo || v > hi) return false;
  out = v;
  return true;
}

// Strict decimal parse into an integer scaled by `scale` (10 = tenths, 100 = hundredths).
bool parseScaled(const char* s, long scale, long lo, long hi, long& out) {
  if (!s || !*s) return false;
  char* end = nullptr;
  const double v = std::strtod(s, &end);
  if (!end || *end != '\0' || !std::isfinite(v)) return false;
  const long scaled = (long)std::lround(v * (double)scale);
  if (scaled < lo || scaled > hi) return false;
  out = scaled;
  return true;
}

bool parseBool(const char* s, bool& out) {
  if (!s) return false;
  if (!std::strcmp(s, "1") || !std::strcmp(s, "true") || !std::strcmp(s, "on")) { out = true; return true; }
  if (!std::strcmp(s, "0") || !std::strcmp(s, "false") || !std::strcmp(s, "off")) { out = false; return true; }
  return false;
}

// Printable ASCII only, for text echoed into JSON or shown on the face.
bool printable(const char* s) {
  for (; *s; ++s) if ((unsigned char)*s < 0x20 || (unsigned char)*s > 0x7E) return false;
  return true;
}

}  // namespace util

// ---------------------------------------------------------------- POSIX TZ rule handling
//
// POSIX form: stdoffset[dst[offset][,start[/time],end[/time]]]
// Offsets are the value added to local time to get UTC, so North America is positive.
// A name is three or more letters or a quoted form such as <+0530> or <-03>.
// DST mode 1 strips the daylight half (standard time all year, DST off); mode 2 keeps the
// daylight offset all year (DST permanently on).

namespace tzrule {

struct Parts {
  char stdName[16];
  char dstName[16];
  long stdOffset;     // seconds
  long dstOffset;     // seconds
  bool hasDst;
};

const char* parseName(const char* s, char* out, size_t n) {
  size_t len = 0;
  if (*s == '<') {
    ++s;
    while (*s && *s != '>') {
      const char c = *s;
      const bool ok = (c >= '0' && c <= '9') || (c >= 'A' && c <= 'Z') || (c >= 'a' && c <= 'z') || c == '+' || c == '-';
      if (!ok || len + 1 >= n) return nullptr;
      out[len++] = *s++;
    }
    if (*s != '>') return nullptr;
    ++s;
  } else {
    while ((*s >= 'A' && *s <= 'Z') || (*s >= 'a' && *s <= 'z')) {
      if (len + 1 >= n) return nullptr;
      out[len++] = *s++;
    }
    if (len < 3) return nullptr;                    // POSIX: unquoted names are 3+ letters
  }
  if (len < 1) return nullptr;
  out[len] = '\0';
  return s;
}

// Offsets: [+|-]hh[:mm[:ss]]. Zone offsets allow 24 hours; transition times allow 167.
const char* parseOffset(const char* s, long& secs, bool& present, long maxHours = 24) {
  present = false;
  int sign = 1;
  if (*s == '+') { ++s; }
  else if (*s == '-') { sign = -1; ++s; }
  if (*s < '0' || *s > '9') return s;
  long v[3] = { 0, 0, 0 };
  for (int field = 0; field < 3; ++field) {
    long acc = 0;
    int digits = 0;
    while (*s >= '0' && *s <= '9' && digits < 3) { acc = acc * 10 + (*s++ - '0'); ++digits; }
    if (digits == 0) return nullptr;
    v[field] = acc;
    if (*s != ':') break;
    ++s;
  }
  if (v[0] > maxHours || v[1] > 59 || v[2] > 59) return nullptr;
  secs = sign * (v[0] * 3600 + v[1] * 60 + v[2]);
  present = true;
  return s;
}

// Transition rule: Jn | n | Mm.w.d, optional /time.
const char* parseDate(const char* s) {
  long a = 0;
  auto num = [&](long lo, long hi) -> bool {
    int digits = 0;
    a = 0;
    while (*s >= '0' && *s <= '9' && digits < 3) { a = a * 10 + (*s++ - '0'); ++digits; }
    return digits > 0 && a >= lo && a <= hi;
  };
  if (*s == 'M') {
    ++s;
    if (!num(1, 12) || *s++ != '.') return nullptr;
    if (!num(1, 5) || *s++ != '.') return nullptr;
    if (!num(0, 6)) return nullptr;
  } else if (*s == 'J') {
    ++s;
    if (!num(1, 365)) return nullptr;
  } else {
    if (!num(0, 365)) return nullptr;
  }
  if (*s == '/') {
    ++s;
    long t = 0;
    bool present = false;
    s = parseOffset(s, t, present, 167);
    if (!s || !present) return nullptr;
  }
  return s;
}

bool parse(const char* tz, Parts& p) {
  if (!tz || !*tz) return false;
  std::memset(&p, 0, sizeof p);
  const char* s = parseName(tz, p.stdName, sizeof p.stdName);
  if (!s) return false;
  bool present = false;
  s = parseOffset(s, p.stdOffset, present);
  if (!s || !present) return false;
  if (*s == '\0') return true;                      // no daylight half
  s = parseName(s, p.dstName, sizeof p.dstName);
  if (!s) return false;
  p.hasDst = true;
  p.dstOffset = p.stdOffset - 3600;                 // POSIX default: one hour ahead
  s = parseOffset(s, p.dstOffset, present);
  if (!s) return false;
  if (*s == '\0') return true;                      // newlib then applies its default rule
  if (*s++ != ',') return false;
  s = parseDate(s);
  if (!s || *s++ != ',') return false;
  s = parseDate(s);
  return s && *s == '\0';
}

void formatOffset(long secs, char* out, size_t n) {
  const long a = secs < 0 ? -secs : secs;
  const int h = (int)(a / 3600), m = (int)((a % 3600) / 60), sec = (int)(a % 60);
  const char* sign = secs < 0 ? "-" : "";
  if (sec) std::snprintf(out, n, "%s%d:%02d:%02d", sign, h, m, sec);
  else if (m) std::snprintf(out, n, "%s%d:%02d", sign, h, m);
  else std::snprintf(out, n, "%s%d", sign, h);
}

void formatName(const char* name, char* out, size_t n) {
  bool plain = std::strlen(name) >= 3;
  for (const char* c = name; *c && plain; ++c)
    if (!((*c >= 'A' && *c <= 'Z') || (*c >= 'a' && *c <= 'z'))) plain = false;
  if (plain) std::snprintf(out, n, "%s", name);
  else std::snprintf(out, n, "<%s>", name);
}

// mode 0 = rule unchanged, 1 = standard offset all year, 2 = daylight offset all year.
// Returns false and copies the input unchanged when the rule cannot be parsed.
bool applyMode(const char* tz, uint8_t mode, char* out, size_t n) {
  if (n == 0) return false;
  util::copyStr(out, n, tz);
  if (mode == 0) return true;
  Parts p;
  if (!parse(tz, p)) return false;
  const bool wantDst = (mode == 2) && p.hasDst;
  char name[20], off[16];
  formatName(wantDst ? p.dstName : p.stdName, name, sizeof name);
  formatOffset(wantDst ? p.dstOffset : p.stdOffset, off, sizeof off);
  std::snprintf(out, n, "%s%s", name, off);
  return true;
}

// POSIX TZ character set, 3..63 characters, and it must parse as a rule.
bool valid(const char* tz) {
  const size_t n = std::strlen(tz);
  if (n < 3 || n > 63) return false;
  for (size_t i = 0; i < n; ++i) {
    const char c = tz[i];
    const bool ok = (c >= 'A' && c <= 'Z') || (c >= 'a' && c <= 'z') || (c >= '0' && c <= '9') ||
                    c == '<' || c == '>' || c == '+' || c == '-' || c == ':' || c == ',' || c == '.' || c == '/';
    if (!ok) return false;
  }
  Parts p;
  return parse(tz, p);
}

}  // namespace tzrule

// ---------------------------------------------------------------- Panel tables and colour math

namespace face {

// Seven segment font, bit 0 = A through bit 6 = G. Letters are the subset that reads
// unambiguously on seven segments.
uint8_t glyph(char c) {
  switch (c) {
    case 'A': return 0b1110111;
    case 'b': return 0b1111100;
    case 'C': return 0b0111001;
    case 'c': return 0b1011000;
    case 'd': return 0b1011110;
    case 'E': return 0b1111001;
    case 'F': return 0b1110001;
    case 'G': return 0b0111101;
    case 'H': return 0b1110110;
    case 'h': return 0b1110100;
    case 'I': return 0b0110000;
    case 'J': return 0b0011110;
    case 'L': return 0b0111000;
    case 'n': return 0b1010100;
    case 'O': return 0b0111111;
    case 'o': return 0b1011100;
    case 'P': return 0b1110011;
    case 'q': return 0b1100111;
    case 'r': return 0b1010000;
    case 'S': return 0b1101101;
    case 't': return 0b1111000;
    case 'U': return 0b0111110;
    case 'u': return 0b0011100;
    case 'y': return 0b1101110;
    case '0': return 0b0111111;
    case '1': return 0b0000110;
    case '2': return 0b1011011;
    case '3': return 0b1001111;
    case '4': return 0b1100110;
    case '5': return 0b1101101;
    case '6': return 0b1111101;
    case '7': return 0b0000111;
    case '8': return 0b1111111;
    case '9': return 0b1101111;
    case '-': return 0b1000000;
    case '_': return 0b0001000;
    default:  return 0;
  }
}

// Each digit is one driver plus one pair of COM pairs. Driver 1 carries the hours, 2 the minutes.
struct Block { uint8_t drv; uint8_t comLo; uint8_t comHi; };
const Block BLOCKS[4] = {
  {0, 0x30, 0xC0},  // hour tens,   annunciator AM
  {0, 0x03, 0x0C},  // hour ones,   annunciator colon (both dots)
  {1, 0x30, 0xC0},  // minute tens, annunciator date dash
  {1, 0x03, 0x0C},  // minute ones, annunciator degree mark
};

// Segment position within a block. Side 0 is COM low, side 1 is COM high. LED n = SEG 3n-2..3n.
struct SegPos { uint8_t side; uint8_t led; };
const SegPos SEGMAP[9] = {
  {1, 5},  // A top
  {1, 4},  // B top right
  {1, 3},  // C bottom right
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  {0, 1},  // second annunciator, block 1 lower colon dot only
};
enum : uint8_t { SEG_ANNUN = 7, SEG_ANNUN2 = 8 };
enum : uint8_t { CH_BLUE = 0, CH_GREEN = 1, CH_RED = 2 };

// Physical LED positions (docs/led-layout.md). id 1..33 is the board layout number, 0 = unwired.
// nx 0..255 runs left to right across the whole panel, ny 0..255 top to bottom of a digit.
struct PosGeom { uint8_t id; uint8_t nx; uint8_t ny; };
const PosGeom GEOM[4][9] = {
  { { 1, 19,   8}, { 7, 41,  66}, { 6, 40, 194}, { 5, 19, 255}, { 4,   0, 188}, { 2,   0,  66}, { 3,  20, 130}, { 8,  20,  65}, {0, 0, 0} },
  { { 9, 93,   0}, {15, 112, 61}, {14, 111, 198}, {13, 90, 246}, {12,  72, 184}, {10,  73,  65}, {11,  92, 124}, {16, 128,  68}, {18, 129, 189} },
  { {19, 163,  5}, {25, 185, 67}, {24, 185, 195}, {23, 165, 247}, {22, 145, 188}, {20, 143,  70}, {21, 164, 122}, {17, 128, 128}, {0, 0, 0} },
  { {27, 233, 11}, {33, 255, 60}, {32, 255, 190}, {31, 234, 249}, {30, 216, 194}, {28, 216,  68}, {29, 235, 128}, {26, 204,  18}, {0, 0, 0} },
};
constexpr uint8_t LED_COUNT = 33;

// Current step to tenths of a mA, from the datasheet.
const uint16_t IS_MA[16] = { 25, 51, 76, 101, 126, 152, 177, 202, 227, 253, 278, 303, 328, 354, 379, 404 };

// Duty is linear light and the web UI sends gamma-encoded colour, so colour and brightness are
// linearised here. 2.8 matches the curve the original firmware was tuned with.
constexpr float PANEL_GAMMA = 2.8f;
constexpr uint8_t COLOR_BITS = 4;
constexpr uint8_t COLOR_LEVELS = 1 << COLOR_BITS;   // duty levels 0..15

float clampf(float v, float lo, float hi) { return v < lo ? lo : (v > hi ? hi : v); }

// Brightness 0..1 -> current step. Perceived output is interpolated between the 2.5 mA floor and
// full, so all sixteen steps are spread across the slider instead of a third of it sitting on
// the floor.
uint8_t currentFor(float brightness) {
  const float pMin = powf((float)IS_MA[0] / (float)IS_MA[15], 1.0f / PANEL_GAMMA);
  const float p = pMin + clampf(brightness, 0.0f, 1.0f) * (1.0f - pMin);
  const float want = powf(p, PANEL_GAMMA) * (float)IS_MA[15];
  uint8_t best = 0;
  for (uint8_t i = 1; i < 16; ++i)
    if (fabsf((float)IS_MA[i] - want) < fabsf((float)IS_MA[best] - want)) best = i;
  return best;
}

// Colour component 0..1 -> duty level 0..15, linearised before rounding so pastels survive.
// Reference definition; only used at boot to build the threshold table below.
uint8_t dutyLevelRef(float c) {
  return (uint8_t)lroundf(powf(clampf(c, 0.0f, 1.0f), PANEL_GAMMA) * (float)(COLOR_LEVELS - 1));
}

// The C3 has no floating-point unit, so powf runs in software and an effect calls this about a
// hundred times per frame. The reference is monotonic, so it is fully described by the smallest
// input reaching each level. Those are found once at boot by bisection over the float bit
// patterns (positive floats order like their bits), and the result is identical for every input.
float dutyThreshold_[COLOR_LEVELS];                // [k] = smallest c with dutyLevelRef(c) >= k
bool  dutyReady_ = false;

void initDutyTable() {
  for (uint8_t k = 1; k < COLOR_LEVELS; ++k) {
    uint32_t lo = 0, hi = 0x3F800000u;             // 0.0f .. 1.0f
    while (lo < hi) {
      const uint32_t mid = lo + (hi - lo) / 2;
      float f;
      std::memcpy(&f, &mid, sizeof f);
      if (dutyLevelRef(f) >= k) hi = mid; else lo = mid + 1;
    }
    std::memcpy(&dutyThreshold_[k], &lo, sizeof lo);
  }
  dutyThreshold_[0] = 0.0f;
  dutyReady_ = true;
}

uint8_t dutyLevel(float c) {
  if (!dutyReady_) return dutyLevelRef(c);
  c = clampf(c, 0.0f, 1.0f);
  uint8_t k = 0;
  while (k + 1 < COLOR_LEVELS && c >= dutyThreshold_[k + 1]) ++k;
  return k;
}

// Full saturation hue (0..1, wraps) to RGB 0..1.
void hueRgb(float h, float out[3]) {
  h -= floorf(h);
  const float x = h * 6.0f;
  const int i = (int)x;
  const float f = x - (float)i;
  switch (i % 6) {
    case 0:  out[0] = 1.0f;     out[1] = f;        out[2] = 0.0f;     break;
    case 1:  out[0] = 1.0f - f; out[1] = 1.0f;     out[2] = 0.0f;     break;
    case 2:  out[0] = 0.0f;     out[1] = 1.0f;     out[2] = f;        break;
    case 3:  out[0] = 0.0f;     out[1] = 1.0f - f; out[2] = 1.0f;     break;
    case 4:  out[0] = f;        out[1] = 0.0f;     out[2] = 1.0f;     break;
    default: out[0] = 1.0f;     out[1] = 0.0f;     out[2] = 1.0f - f; break;
  }
}

// Projection of every LED onto an axis at `angleDeg` (0 = left to right, 90 = top to bottom),
// normalised against the LEDs themselves so both ends of a ramp land on real LEDs.
// perLed[blk][seg] is 0..1; perBlock[blk] is each digit's mean, normalised end to end.
void projectAxis(float angleDeg, float perLed[4][9], float perBlock[4]) {
  const float a = angleDeg * 3.14159265f / 180.0f;
  const float ca = cosf(a), sa = sinf(a);
  float lo = 1e9f, hi = -1e9f;
  for (int b = 0; b < 4; ++b)
    for (int s = 0; s < 9; ++s) {
      if (!GEOM[b][s].id) continue;
      const float t = (GEOM[b][s].nx / 255.0f) * ca + (GEOM[b][s].ny / 255.0f) * sa;
      if (t < lo) lo = t;
      if (t > hi) hi = t;
    }
  float span = hi - lo;
  if (span < 1e-6f) span = 1.0f;
  float blo = 1e9f, bhi = -1e9f;
  for (int b = 0; b < 4; ++b) {
    float sum = 0.0f;
    int n = 0;
    for (int s = 0; s < 9; ++s) {
      perLed[b][s] = 0.0f;
      if (!GEOM[b][s].id) continue;
      const float t = ((GEOM[b][s].nx / 255.0f) * ca + (GEOM[b][s].ny / 255.0f) * sa - lo) / span;
      perLed[b][s] = clampf(t, 0.0f, 1.0f);
      sum += perLed[b][s];
      ++n;
    }
    perBlock[b] = n ? sum / (float)n : 0.0f;
    if (perBlock[b] < blo) blo = perBlock[b];
    if (perBlock[b] > bhi) bhi = perBlock[b];
  }
  float bspan = bhi - blo;
  if (bspan < 1e-6f) bspan = 1.0f;
  for (int b = 0; b < 4; ++b) perBlock[b] = (perBlock[b] - blo) / bspan;
}

}  // namespace face

// ============================================================================ PANEL DRIVER (AiP33628 x2)

namespace panel {

// Scan: four COM pairs per driver, each 600 us, split into binary weighted sub-frames of 40, 80,
// 160 and 320 us. A channel at duty level L is lit in sub-frame k when bit k of L is set, so
// four sub-frames give sixteen levels. Full cycle 2400 us, 416.7 Hz. Identical neighbouring
// sub-frames merge, so a saturated colour costs one frame per COM pair.
//
// One timer interrupt per scan step: the counter runs free and each interrupt moves the alarm on
// by that step's dwell (Espressif's dynamic alarm pattern, no auto-reload). On the single-core
// C3 a fixed 40 us tick costs 25,000 interrupts a second whatever is shown; per step it is
// 1,667 a second for solid colours and 6,667 at most.
constexpr uint32_t UNIT_US = 40;
constexpr uint8_t  MAX_STEPS = 4 * face::COLOR_BITS;
const uint8_t COM_SEQ[4] = { 0x30, 0x0C, 0x03, 0xC0 };   // stock scan order

// Current step to the nibble on the wire: IS[0] travels at bit 27 and IS[3] at bit 24, so the
// field is bit reversed against the rest of the frame. Self-inverse.
DRAM_ATTR const uint8_t IS_WIRE[16] = { 0x0, 0x8, 0x4, 0xC, 0x2, 0xA, 0x6, 0xE,
                                        0x1, 0x9, 0x5, 0xD, 0x3, 0xB, 0x7, 0xF };

constexpr uint32_t M_CLK    = 1UL << PIN_CLK;
constexpr uint32_t M_DATA   = 1UL << PIN_DATA;
constexpr uint32_t M_CLK_1  = 1UL << PIN_CLK_1;
constexpr uint32_t M_DATA_1 = 1UL << PIN_DATA_1;

struct ScanStep {
  uint8_t  units;   // dwell in UNIT_US ticks, 1..15
  uint8_t  cs;
  uint16_t ss[2];
};

struct ScanBuf {
  ScanStep step[MAX_STEPS];
  uint8_t  n;
  uint8_t  is;
};

// Written by the loop task, read by the ISR. render() fills the back buffer and flips front_.
ScanBuf buf_[2];
volatile uint8_t front_ = 0;
volatile uint8_t step_ = 0;
volatile uint32_t isrCount_ = 0;                   // scan steps latched, for the interrupts-per-second figure
volatile uint32_t earlyCount_ = 0;                 // alarms that fired before their time
volatile uint32_t lateCount_ = 0;                  // alarms serviced after the next one was already due
bool timerOk_ = false;
gptimer_handle_t timer_ = nullptr;
uint8_t pauseDepth_ = 0;                           // nested pauseForFlash calls, loop task only

static inline void IRAM_ATTR edgeDelay() {
  for (int i = 0; i < BUS_EDGE_NOPS; ++i) __asm__ __volatile__("nop");
}

// One 30-bit frame to each driver, both buses clocked together, then latched. LSB first:
// SS[15:0], CS[7:0], IS[3:0], two reserved zeros. Data changes only while CLK is low. The latch
// is a DATA rising edge while CLK is held high after bit 29.
void IRAM_ATTR sendPair(uint16_t ss1, uint16_t ss2, uint8_t cs, uint8_t is) {
  const uint32_t wire = (uint32_t)IS_WIRE[is & 0xF] << 24;
  uint32_t f1 = (uint32_t)ss1 | ((uint32_t)cs << 16) | wire;
  uint32_t f2 = (uint32_t)ss2 | ((uint32_t)cs << 16) | wire;
  const uint32_t clks = M_CLK | M_CLK_1;
  const uint32_t dats = M_DATA | M_DATA_1;

  REG_WRITE(GPIO_OUT_W1TC_REG, clks | dats);
  edgeDelay();
  for (int i = 0; i < 30; ++i) {
    uint32_t set = 0;
    if (f1 & 1u) set |= M_DATA;
    if (f2 & 1u) set |= M_DATA_1;
    f1 >>= 1;
    f2 >>= 1;
    REG_WRITE(GPIO_OUT_W1TC_REG, dats & ~set);
    REG_WRITE(GPIO_OUT_W1TS_REG, set);
    edgeDelay();
    REG_WRITE(GPIO_OUT_W1TS_REG, clks);              // rising edge shifts both buses
    edgeDelay();
    if (i < 29) {
      REG_WRITE(GPIO_OUT_W1TC_REG, clks);
      edgeDelay();
    }
  }
  REG_WRITE(GPIO_OUT_W1TC_REG, dats);
  edgeDelay();
  REG_WRITE(GPIO_OUT_W1TS_REG, dats);                // DATA rising while CLK high: latch
  edgeDelay();
  REG_WRITE(GPIO_OUT_W1TC_REG, dats);
  edgeDelay();
  REG_WRITE(GPIO_OUT_W1TC_REG, clks);
}

// Latch the next step, then move the alarm on by that step's dwell from the alarm that fired, so
// timing does not accumulate interrupt latency. If this interrupt ran so late that the next
// alarm would already be due (interrupts are held off while flash is written), the dwell is
// counted from now instead: one long step, never a burst of catch-up interrupts.
// A genuine alarm always finds the counter at or past its alarm value. One that does not fired
// early: it is re-armed for the same value and the step is not advanced, so it can neither cut a
// sub-frame short nor skew the colour weighting.
bool IRAM_ATTR scanTick(gptimer_handle_t timer, const gptimer_alarm_event_data_t* ev, void*) {
  if (ev->count_value < ev->alarm_value) {
    earlyCount_ = earlyCount_ + 1;
    gptimer_alarm_config_t again = {};
    again.alarm_count = ev->alarm_value;
    gptimer_set_alarm_action(timer, &again);
    return false;
  }
  isrCount_ = isrCount_ + 1;
  const ScanBuf& b = buf_[front_];
  uint32_t units = 15;                             // empty schedule: idle one COM slot
  if (b.n > 0) {
    uint8_t i = step_;
    if (i >= b.n) i = 0;                           // schedule may have shrunk at a flip
    const ScanStep& st = b.step[i];
    sendPair(st.ss[0], st.ss[1], st.cs, b.is);
    units = st.units;
    const uint8_t next = (uint8_t)(i + 1);
    step_ = next >= b.n ? 0 : next;
  }
  const uint64_t dwell = (uint64_t)units * UNIT_US;
  uint64_t now = ev->count_value;
  gptimer_get_raw_count(timer, &now);
  gptimer_alarm_config_t a = {};
  a.alarm_count = ev->alarm_value + dwell;
  if (a.alarm_count < now + UNIT_US / 2) {
    a.alarm_count = now + dwell;
    lateCount_ = lateCount_ + 1;
  }
  gptimer_set_alarm_action(timer, &a);
  return false;
}

// Panel state, owned by the loop task.
bool    on_[4][9];          // which positions are lit
uint8_t level_[4][9][3];    // duty level per channel, indexed CH_*
uint8_t is_ = 0;            // current step for the next render

// Collapse on_ and level_ into a scan schedule and publish it.
void render() {
  uint16_t sub[2][4][face::COLOR_BITS];
  std::memset(sub, 0, sizeof sub);
  for (int blk = 0; blk < 4; ++blk) {
    const face::Block& b = face::BLOCKS[blk];
    for (int seg = 0; seg < 9; ++seg) {
      if (!on_[blk][seg]) continue;
      const face::SegPos& sp = face::SEGMAP[seg];
      const uint8_t cs = sp.side ? b.comHi : b.comLo;
      int ci = 0;
      for (int k = 0; k < 4; ++k) if (COM_SEQ[k] == cs) ci = k;
      const int base = 3 * sp.led - 2;
      for (int ch = 0; ch < 3; ++ch) {
        const uint8_t lv = level_[blk][seg][ch];
        if (!lv) continue;
        const uint16_t bit = (uint16_t)(1u << (base + ch));
        for (int k = 0; k < face::COLOR_BITS; ++k)
          if (lv & (1u << k)) sub[b.drv][ci][k] |= bit;
      }
    }
  }

  ScanBuf& out = buf_[front_ ^ 1];
  out.n = 0;
  for (int ci = 0; ci < 4; ++ci) {
    for (int k = 0; k < face::COLOR_BITS; ++k) {
      const uint16_t s0 = sub[0][ci][k], s1 = sub[1][ci][k];
      const uint8_t units = (uint8_t)(1u << k);
      if (k > 0 && out.n > 0 && out.step[out.n - 1].ss[0] == s0 && out.step[out.n - 1].ss[1] == s1) {
        out.step[out.n - 1].units = (uint8_t)(out.step[out.n - 1].units + units);
        continue;
      }
      ScanStep& st = out.step[out.n++];
      st.units = units;
      st.ss[0] = s0;
      st.ss[1] = s1;
      st.cs = COM_SEQ[ci];
    }
  }
  out.is = is_;
  __sync_synchronize();                              // complete the buffer before the flip
  front_ = (uint8_t)(front_ ^ 1);
}

void blankNow() {
  std::memset(on_, 0, sizeof on_);
  render();
}

// Pins low and the panel blanked before the scan starts, so nothing random is latched at boot.
void begin() {
  for (int p : { PIN_CLK, PIN_DATA, PIN_CLK_1, PIN_DATA_1 }) {
    pinMode(p, OUTPUT);
    digitalWrite(p, LOW);
  }
  delayMicroseconds(250);                            // AiP33628 ignores the first 200 us after POR
  std::memset(on_, 0, sizeof on_);
  std::memset(level_, 0, sizeof level_);
  std::memset(buf_, 0, sizeof buf_);
  render();
  sendPair(0, 0, 0, 0);                              // blank both latches immediately

  gptimer_config_t tcfg = {};
  tcfg.clk_src = GPTIMER_CLK_SRC_DEFAULT;
  tcfg.direction = GPTIMER_COUNT_UP;
  tcfg.resolution_hz = 1000000;                      // 1 tick per microsecond

  gptimer_alarm_config_t acfg = {};
  acfg.alarm_count = UNIT_US;

  gptimer_event_callbacks_t cbs = {};
  cbs.on_alarm = scanTick;

  timerOk_ = gptimer_new_timer(&tcfg, &timer_) == ESP_OK &&
             gptimer_register_event_callbacks(timer_, &cbs, nullptr) == ESP_OK &&
             gptimer_set_alarm_action(timer_, &acfg) == ESP_OK &&
             gptimer_enable(timer_) == ESP_OK &&
             gptimer_start(timer_) == ESP_OK;
  if (!timerOk_) Serial.println("ERROR: display scan timer could not be started");
}

bool timerOk() { return timerOk_; }

// The scan interrupt is not cache-safe in this core build, so it is masked while flash is being
// written and whichever COM pair was last latched would stay lit at four times its duty. Blank
// the drivers and stop the scan around every flash write instead: a few milliseconds dark.
// Calls nest; only the outermost pair stops and restarts the scan.
void pauseForFlash() {
  if (pauseDepth_++ > 0) return;
  if (timerOk_) gptimer_stop(timer_);
  sendPair(0, 0, 0, 0);
}

void resumeAfterFlash() {
  if (pauseDepth_ == 0) return;
  if (--pauseDepth_ > 0) return;
  step_ = 0;
  if (timerOk_) {
    uint64_t now = 0;
    gptimer_get_raw_count(timer_, &now);
    gptimer_alarm_config_t a = {};
    a.alarm_count = now + UNIT_US;
    gptimer_set_alarm_action(timer_, &a);
    gptimer_start(timer_);
  }
}

uint32_t isrCount() { return isrCount_; }
uint32_t earlyCount() { return earlyCount_; }
uint32_t lateCount() { return lateCount_; }
uint8_t steps() { return buf_[front_].n; }       // scan steps per 2400 us cycle in the live schedule

}  // namespace panel

// ============================================================================ SETTINGS (NVS)

enum : uint8_t { CM_SOLID = 0, CM_DIGIT = 1, CM_GRADIENT = 2, CM_CUSTOM = 3 };
enum : uint8_t { FX_NONE = 0, FX_CYCLE = 1, FX_FLASH = 2 };
enum : uint8_t { SP_PANEL = 0, SP_DIGIT = 1, SP_LED = 2 };
enum : uint8_t { DST_AUTO = 0, DST_STANDARD = 1, DST_DAYLIGHT = 2 };

struct Settings {
  // ---- time and radio (NtpClockMod layout)
  // lwIP is handed these by POINTER and keeps them for as long as it runs, so they live here,
  // at file scope, and are never moved or freed.
  char     ntpServer[64];
  char     ntpServer2[64];    // empty = slot unused
  char     ntpServer3[64];
  char     hostname[33];      // mDNS / DHCP name, 1..32 of [a-z0-9-]
  char     webUser[33];       // web login; empty = no login
  char     webPass[65];
  char     otaPass[65];       // Arduino IDE network upload; empty = none
  bool     ntpFailover;       // false = slot 0 only, never try another server
  char     tz[64];            // POSIX rule as chosen in the UI, before the DST mode is applied
  uint32_t syncIntervalS;
  uint8_t  dstMode;
  int8_t   wifiTxDbm;         // 2..20, quantised by the radio to the steps above
  uint8_t  wifiPsMode;        // 0 none, 1 min modem, 2 max modem
  // ---- display
  uint8_t  lightOn;
  uint8_t  brightness;        // 1..100 percent
  uint8_t  maxCurrent;        // 0..15
  uint8_t  rgb[3];            // solid colour
  uint8_t  twelveHour;
  uint8_t  blinkColon;
  uint8_t  leadingZero;
  uint8_t  colonStatus;       // 1 = upper colon dot shows sync health
  uint8_t  colorMode;         // CM_*
  uint8_t  digitRgb[4][3];
  uint8_t  gradA[3];
  uint8_t  gradB[3];
  int16_t  gradAngle;         // -180..180 degrees
  uint8_t  ledRgb[33][3];     // index = board id - 1
  uint8_t  effect;            // FX_*
  uint8_t  spread;            // SP_*
  int16_t  effectAngle;       // -180..180 degrees
  uint16_t hueSpan;           // 0..360 degrees
  uint16_t effectSpeedDs;     // seconds x10, 2..6000
  uint16_t flashFadeCs;       // seconds x100, 0..3000
  uint16_t dateEveryS;        // 0 = off, else 10..3600
  uint16_t dateShowMs;        // 500..10000
  uint8_t  dateFormat;        // 0 = MM-DD, 1 = DD-MM
  uint8_t  nightEnabled;
  uint16_t nightStartMin;     // 0..1439
  uint16_t nightEndMin;       // 0..1439
  uint8_t  nightBrightness;   // 0 = display off at night, else 1..100
};

// The transmit powers the radio can actually produce, in dBm. Anything else rounds down.
const int8_t WIFI_TX_STEPS[] = { 2, 5, 7, 8, 11, 13, 14, 15, 16, 18, 20 };
const uint8_t WIFI_TX_STEPS_N = sizeof WIFI_TX_STEPS / sizeof WIFI_TX_STEPS[0];

Settings g_settings;
uint32_t g_bootCount = 0;
esp_reset_reason_t g_resetReason = ESP_RST_UNKNOWN;

// Forward declarations: settings writes pause the display scan around flash.
namespace panel { void pauseForFlash(); void resumeAfterFlash(); }

namespace settings {

namespace impl {

const char* const NVS_NS = "hu058";

bool isAlnum(char c) {
  return (c >= 'a' && c <= 'z') || (c >= 'A' && c <= 'Z') || (c >= '0' && c <= '9');
}

bool dirty_ = false;
uint32_t dirtySinceMs_ = 0;
bool pinned_ = false;                              // name and passwords are in NVS, not just the defaults
bool resetPending_ = false;                        // cleared for a factory reset: write nothing until restart
bool lastSaveOk_ = true;

}  // namespace impl

// Hostname or IPv4 literal, 1..63 characters.
bool validNtpServer(const char* s) {
  const size_t n = std::strlen(s);
  if (n == 0 || n > 63) return false;
  char prev = '.';                                   // forbids a leading '.' or '-'
  for (size_t i = 0; i < n; ++i) {
    const char c = s[i];
    if (c == '.') {
      if (prev == '.' || prev == '-') return false;   // empty label or label ending in '-'
    } else if (c == '-') {
      if (prev == '.') return false;                  // label starting with '-'
    } else if (!impl::isAlnum(c)) {
      return false;
    }
    prev = c;
  }
  return prev != '.' && prev != '-';
}

// Snap a requested transmit power to a step the radio can actually produce, never upward.
int8_t quantiseTxDbm(int v) {
  if (v <= WIFI_TX_STEPS[0]) return WIFI_TX_STEPS[0];
  for (uint8_t i = WIFI_TX_STEPS_N; i-- > 0; )
    if (v >= WIFI_TX_STEPS[i]) return WIFI_TX_STEPS[i];
  return WIFI_TX_STEPS[0];
}

bool validTz(const char* s) { return tzrule::valid(s); }

// Login name: printable ASCII without ':' (it separates name and password in HTTP basic auth).
bool validUser(const char* s) {
  const size_t n = std::strlen(s);
  if (n > 32) return false;
  for (size_t i = 0; i < n; ++i) if (s[i] < 0x20 || s[i] > 0x7E || s[i] == ':') return false;
  return true;
}

bool validPassword(const char* s) {
  return std::strlen(s) <= 64 && util::printable(s);
}

// RFC 1123 host label, lower case: [a-z0-9-], not starting or ending with '-'. New names are
// held to 31 characters, the most the core passes to DHCP; a stored 32-character name from
// 01.02.02 still loads, so no clock is renamed.
bool validHostname(const char* s, size_t maxLen = 32) {
  const size_t n = std::strlen(s);
  if (n < 1 || n > maxLen || s[0] == '-' || s[n - 1] == '-') return false;
  for (size_t i = 0; i < n; ++i) {
    const char c = s[i];
    if (!((c >= 'a' && c <= 'z') || (c >= '0' && c <= '9') || c == '-')) return false;
  }
  return true;
}

uint32_t clampInterval(uint32_t s) {
  if (s < NTP_MIN_INTERVAL_S) return NTP_MIN_INTERVAL_S;
  if (s > NTP_MAX_INTERVAL_S) return NTP_MAX_INTERVAL_S;
  return s;
}

// Effective POSIX rule: the stored zone rule with the DST mode applied.
void effectiveTz(char* out, size_t n) {
  tzrule::applyMode(g_settings.tz, g_settings.dstMode, out, n);
}

void defaults() {
  Settings& s = g_settings;
  std::memset(&s, 0, sizeof s);
  util::copyStr(s.ntpServer, sizeof s.ntpServer, DEFAULT_NTP_SERVER);
  util::copyStr(s.ntpServer2, sizeof s.ntpServer2, DEFAULT_NTP_SERVER2);
  util::copyStr(s.ntpServer3, sizeof s.ntpServer3, DEFAULT_NTP_SERVER3);
  util::copyStr(s.hostname, sizeof s.hostname, validHostname(DEVICE_HOSTNAME, 31) ? DEVICE_HOSTNAME : FALLBACK_HOSTNAME);
  util::copyStr(s.webUser, sizeof s.webUser, validUser(WEB_AUTH_USER) ? WEB_AUTH_USER : "");
  util::copyStr(s.webPass, sizeof s.webPass, validPassword(WEB_AUTH_PASS) ? WEB_AUTH_PASS : "");
  util::copyStr(s.otaPass, sizeof s.otaPass, validPassword(OTA_PASSWORD) ? OTA_PASSWORD : "");
  s.ntpFailover = NTP_FAILOVER_DEFAULT;
  util::copyStr(s.tz, sizeof s.tz, DEFAULT_TZ);
  s.syncIntervalS = DEFAULT_SYNC_INTERVAL_S;
  s.dstMode = DEFAULT_DST_MODE;
  s.wifiTxDbm = WIFI_TX_DBM_DEFAULT;
  s.wifiPsMode = WIFI_PS_MODE_DEFAULT;
  s.lightOn = DEFAULT_LIGHT_ON;
  s.brightness = DEFAULT_BRIGHTNESS;
  s.maxCurrent = DEFAULT_MAX_CURRENT;
  s.rgb[0] = DEFAULT_COLOR_R; s.rgb[1] = DEFAULT_COLOR_G; s.rgb[2] = DEFAULT_COLOR_B;
  s.twelveHour = DEFAULT_TWELVE_HOUR;
  s.blinkColon = DEFAULT_BLINK_COLON;
  s.leadingZero = DEFAULT_LEADING_ZERO;
  s.colonStatus = DEFAULT_COLON_STATUS;
  s.colorMode = CM_SOLID;
  const uint8_t demo[4][3] = { {255, 0, 0}, {255, 115, 0}, {0, 255, 64}, {26, 77, 255} };
  std::memcpy(s.digitRgb, demo, sizeof demo);
  s.gradA[0] = 0;   s.gradA[1] = 255; s.gradA[2] = 26;
  s.gradB[0] = 255; s.gradB[1] = 217; s.gradB[2] = 0;
  s.gradAngle = -45;
  for (uint8_t i = 0; i < 33; ++i) { s.ledRgb[i][0] = 255; s.ledRgb[i][1] = 255; s.ledRgb[i][2] = 255; }
  s.effect = FX_NONE;
  s.spread = SP_PANEL;
  s.effectAngle = 0;
  s.hueSpan = 90;
  s.effectSpeedDs = 100;
  s.flashFadeCs = 0;
  s.dateEveryS = 0;
  s.dateShowMs = 2000;
  s.dateFormat = 0;
  s.nightEnabled = 0;
  s.nightStartMin = 22 * 60;
  s.nightEndMin = 7 * 60;
  s.nightBrightness = 5;
}

// Firmware before 01.02.00 kept one settings record ("cfg") and a Wi-Fi reconnect hint ("hint")
// in "hu058clk". Not carried over: the layout differs. Cleared once so they stop occupying NVS.
void dropLegacy() {
  Preferences p;
  if (!p.begin("hu058clk", true)) return;          // absent: nothing to do, nothing created
  const bool stale = p.isKey("cfg") || p.isKey("hint");
  p.end();
  if (!stale) return;
  panel::pauseForFlash();
  if (p.begin("hu058clk", false)) { p.clear(); p.end(); }
  panel::resumeAfterFlash();
  Serial.println("Settings from firmware before 01.02.00 cleared; defaults in use");
}

// Every key is read with its own validation; anything missing or out of range keeps its default.
void load() {
  dropLegacy();
  defaults();
  Settings& s = g_settings;
  Preferences p;
  if (!p.begin(impl::NVS_NS, true)) return;        // nothing stored yet: defaults
  char buf[64];
  if (p.isKey("ntp") && p.getString("ntp", buf, sizeof buf) > 0 && validNtpServer(buf))
    util::copyStr(s.ntpServer, sizeof s.ntpServer, buf);
  // getString returns 0 WITHOUT writing to buf on a read error, so buf is cleared first: a
  // failure then reads as an empty fallback, never as the previous key's value.
  if (p.isKey("ntp2")) {
    buf[0] = '\0'; p.getString("ntp2", buf, sizeof buf);
    if (buf[0] == '\0' || validNtpServer(buf)) util::copyStr(s.ntpServer2, sizeof s.ntpServer2, buf);
  }
  if (p.isKey("ntp3")) {
    buf[0] = '\0'; p.getString("ntp3", buf, sizeof buf);
    if (buf[0] == '\0' || validNtpServer(buf)) util::copyStr(s.ntpServer3, sizeof s.ntpServer3, buf);
  }
  s.ntpFailover = p.getBool("ntpfo", NTP_FAILOVER_DEFAULT);
  bool hostOk = false, userOk = false, passOk = false, otaOk = false;
  if (p.isKey("host") && p.getString("host", buf, sizeof buf) > 0 && validHostname(buf)) {
    util::copyStr(s.hostname, sizeof s.hostname, buf);
    hostOk = true;
  }
  // Empty values are valid here (no login, no password), so a read is judged by getString's
  // return, which counts the terminator: 0 only on failure.
  {
    char pw[65];
    if (p.isKey("wuser") && p.getString("wuser", buf, sizeof buf) > 0 && validUser(buf)) {
      util::copyStr(s.webUser, sizeof s.webUser, buf);
      userOk = true;
    }
    if (p.isKey("wpwd") && p.getString("wpwd", pw, sizeof pw) > 0 && validPassword(pw)) {
      util::copyStr(s.webPass, sizeof s.webPass, pw);
      passOk = true;
    }
    if (p.isKey("otapw") && p.getString("otapw", pw, sizeof pw) > 0 && validPassword(pw)) {
      util::copyStr(s.otaPass, sizeof s.otaPass, pw);
      otaOk = true;
    }
  }
  impl::pinned_ = hostOk && userOk && passOk && otaOk;
  if (p.isKey("tz") && p.getString("tz", buf, sizeof buf) > 0 && validTz(buf))
    util::copyStr(s.tz, sizeof s.tz, buf);
  s.syncIntervalS = clampInterval(p.getULong("ival", DEFAULT_SYNC_INTERVAL_S));
  const uint8_t dst = p.getUChar("dst", DEFAULT_DST_MODE);
  s.dstMode = dst <= DST_DAYLIGHT ? dst : (uint8_t)DST_AUTO;
  s.wifiTxDbm = quantiseTxDbm(p.getChar("wtx", WIFI_TX_DBM_DEFAULT));
  const uint8_t ps = p.getUChar("wps", WIFI_PS_MODE_DEFAULT);
  s.wifiPsMode = ps <= 2 ? ps : (uint8_t)0;

  auto u8 = [&](const char* k, uint8_t def, uint8_t lo, uint8_t hi) {
    const uint8_t v = p.getUChar(k, def);
    return (v < lo || v > hi) ? def : v;
  };
  auto u16 = [&](const char* k, uint16_t def, uint16_t lo, uint16_t hi) {
    const uint16_t v = p.getUShort(k, def);
    return (v < lo || v > hi) ? def : v;
  };
  auto i16 = [&](const char* k, int16_t def, int16_t lo, int16_t hi) {
    const int16_t v = p.getShort(k, def);
    return (v < lo || v > hi) ? def : v;
  };
  auto bytes = [&](const char* k, void* dst, size_t n) {
    if (p.getBytesLength(k) == n) p.getBytes(k, dst, n);
  };
  s.lightOn = u8("on", s.lightOn, 0, 1);
  s.brightness = u8("bri", s.brightness, 1, 100);
  s.maxCurrent = u8("maxi", s.maxCurrent, 0, 15);
  bytes("rgb", s.rgb, sizeof s.rgb);
  s.twelveHour = u8("h12", s.twelveHour, 0, 1);
  s.blinkColon = u8("blink", s.blinkColon, 0, 1);
  s.leadingZero = u8("lz", s.leadingZero, 0, 1);
  s.colonStatus = u8("colon", s.colonStatus, 0, 1);
  s.colorMode = u8("cmode", s.colorMode, 0, CM_CUSTOM);
  bytes("digits", s.digitRgb, sizeof s.digitRgb);
  bytes("ga", s.gradA, sizeof s.gradA);
  bytes("gb", s.gradB, sizeof s.gradB);
  s.gradAngle = i16("gang", s.gradAngle, -180, 180);
  bytes("leds", s.ledRgb, sizeof s.ledRgb);
  s.effect = u8("fx", s.effect, 0, FX_FLASH);
  s.spread = u8("spread", s.spread, 0, SP_LED);
  s.effectAngle = i16("fxang", s.effectAngle, -180, 180);
  s.hueSpan = u16("hue", s.hueSpan, 0, 360);
  s.effectSpeedDs = u16("speed", s.effectSpeedDs, 2, 6000);
  s.flashFadeCs = u16("fade", s.flashFadeCs, 0, 3000);
  s.dateEveryS = u16("dateev", s.dateEveryS, 0, 3600);
  if (s.dateEveryS != 0 && s.dateEveryS < 10) s.dateEveryS = 0;
  s.dateShowMs = u16("datesh", s.dateShowMs, 500, 10000);
  s.dateFormat = u8("datefmt", s.dateFormat, 0, 1);
  s.nightEnabled = u8("night", s.nightEnabled, 0, 1);
  s.nightStartMin = u16("nstart", s.nightStartMin, 0, 1439);
  s.nightEndMin = u16("nend", s.nightEndMin, 0, 1439);
  s.nightBrightness = u8("nbri", s.nightBrightness, 0, 100);
  p.end();
}

// Write a string and read it back. putString returns 0 both for a failed write and for an
// empty value, so the read-back is the only sound test, and it also covers clearing a value.
bool putStr(Preferences& p, const char* key, const char* value) {
  p.putString(key, value);
  char back[72];
  const size_t n = p.getString(key, back, sizeof back);
  return n == std::strlen(value) + 1 && std::strcmp(back, value) == 0;
}

// Writes every key. NVS skips a value that is unchanged, so only what moved costs flash.
bool save() {
  if (impl::resetPending_) return false;           // a factory reset is waiting for its restart
  const Settings& s = g_settings;
  Preferences p;
  panel::pauseForFlash();
  bool ok = p.begin(impl::NVS_NS, false);
  if (ok) {
    ok = putStr(p, "ntp", s.ntpServer);
    ok = putStr(p, "ntp2", s.ntpServer2) && ok;
    ok = putStr(p, "ntp3", s.ntpServer3) && ok;
    ok = p.putBool("ntpfo", s.ntpFailover) > 0 && ok;
    ok = putStr(p, "host", s.hostname) && ok;
    ok = putStr(p, "wuser", s.webUser) && ok;
    ok = putStr(p, "wpwd", s.webPass) && ok;
    ok = putStr(p, "otapw", s.otaPass) && ok;
    ok = putStr(p, "tz", s.tz) && ok;
    ok = p.putULong("ival", s.syncIntervalS) > 0 && ok;
    ok = p.putUChar("dst", s.dstMode) > 0 && ok;
    ok = p.putChar("wtx", s.wifiTxDbm) > 0 && ok;
    ok = p.putUChar("wps", s.wifiPsMode) > 0 && ok;
    ok = p.putUChar("on", s.lightOn) > 0 && ok;
    ok = p.putUChar("bri", s.brightness) > 0 && ok;
    ok = p.putUChar("maxi", s.maxCurrent) > 0 && ok;
    ok = p.putBytes("rgb", s.rgb, sizeof s.rgb) == sizeof s.rgb && ok;
    ok = p.putUChar("h12", s.twelveHour) > 0 && ok;
    ok = p.putUChar("blink", s.blinkColon) > 0 && ok;
    ok = p.putUChar("lz", s.leadingZero) > 0 && ok;
    ok = p.putUChar("colon", s.colonStatus) > 0 && ok;
    ok = p.putUChar("cmode", s.colorMode) > 0 && ok;
    ok = p.putBytes("digits", s.digitRgb, sizeof s.digitRgb) == sizeof s.digitRgb && ok;
    ok = p.putBytes("ga", s.gradA, sizeof s.gradA) == sizeof s.gradA && ok;
    ok = p.putBytes("gb", s.gradB, sizeof s.gradB) == sizeof s.gradB && ok;
    ok = p.putShort("gang", s.gradAngle) > 0 && ok;
    ok = p.putBytes("leds", s.ledRgb, sizeof s.ledRgb) == sizeof s.ledRgb && ok;
    ok = p.putUChar("fx", s.effect) > 0 && ok;
    ok = p.putUChar("spread", s.spread) > 0 && ok;
    ok = p.putShort("fxang", s.effectAngle) > 0 && ok;
    ok = p.putUShort("hue", s.hueSpan) > 0 && ok;
    ok = p.putUShort("speed", s.effectSpeedDs) > 0 && ok;
    ok = p.putUShort("fade", s.flashFadeCs) > 0 && ok;
    ok = p.putUShort("dateev", s.dateEveryS) > 0 && ok;
    ok = p.putUShort("datesh", s.dateShowMs) > 0 && ok;
    ok = p.putUChar("datefmt", s.dateFormat) > 0 && ok;
    ok = p.putUChar("night", s.nightEnabled) > 0 && ok;
    ok = p.putUShort("nstart", s.nightStartMin) > 0 && ok;
    ok = p.putUShort("nend", s.nightEndMin) > 0 && ok;
    ok = p.putUChar("nbri", s.nightBrightness) > 0 && ok;
    p.end();
  }
  panel::resumeAfterFlash();
  impl::lastSaveOk_ = ok;
  if (ok) { impl::dirty_ = false; impl::pinned_ = true; }
  else Serial.println("ERROR: settings save failed");
  return ok;
}

// Display changes arrive while a slider is dragged: written once, SETTINGS_SAVE_DELAY_MS after
// the last one, so a drag costs one flash write instead of fifty.
void markDirty() {
  impl::dirty_ = true;
  impl::dirtySinceMs_ = millis();
}

void loop() {
  if (impl::dirty_ && millis() - impl::dirtySinceMs_ >= SETTINGS_SAVE_DELAY_MS) {
    if (!save()) impl::dirtySinceMs_ = millis();     // retry after another delay
  }
}

bool dirty() { return impl::dirty_; }
bool pinned() { return impl::pinned_; }
bool lastSaveOk() { return impl::lastSaveOk_; }
bool resetPending() { return impl::resetPending_; }

// Clears every stored setting; the next boot starts from the defaults. Wi-Fi ("hu058net") and
// the boot record ("hu058sys") are kept. From here until the restart nothing is saved, so a
// pending display change or a late request cannot write the old settings back.
bool factoryReset() {
  impl::resetPending_ = true;
  impl::dirty_ = false;
  Preferences p;
  panel::pauseForFlash();
  bool ok = p.begin(impl::NVS_NS, false);
  if (ok) {
    ok = p.clear();
    p.end();
  }
  panel::resumeAfterFlash();
  if (!ok) Serial.println("ERROR: factory reset could not clear the settings");
  return ok;
}

}  // namespace settings

// ============================================================================ TIMEKEEPING (SNTP + TZ)

namespace timekeeping {

namespace impl {

char              server_[64];          // lwIP keeps this pointer, so it must stay valid
char              activeTz_[64];        // effective POSIX rule in use
SemaphoreHandle_t tzMutex_ = nullptr;
portMUX_TYPE      mux_ = portMUX_INITIALIZER_UNLOCKED;
time_t            lastSyncEpoch_ = 0;
int64_t           lastSyncUs_ = -1;
int64_t           baseNtpUs_ = 0;       // NTP time at the drift baseline sync, microseconds
int64_t           baseEspUs_ = 0;       // esp_timer at that same sync
bool              haveBase_ = false;
// Mid-point sample. The long baseline gives the low-noise figure; a second sample taken part
// way along gives a recent-window rate, which is what moves when the board's temperature does.
// Without it a rate shift takes as long to show as the whole baseline, because a two-point
// estimate from a fixed origin averages everything since boot.
int64_t           midNtpUs_ = 0;
int64_t           midEspUs_ = 0;
bool              haveMid_ = false;
float             recentPpm_ = 0.0f;
uint32_t          recentSpanS_ = 0;
uint8_t           activeSlot_ = 0;      // which configured server is currently installed
uint32_t          slotSinceMs_ = 0;     // millis() when it was installed
uint32_t          slotSyncCount_ = 0;   // syncCount_ then; proves THIS server replied
float             driftPpm_ = 0.0f;     // crystal fast(+) / slow(-) versus NTP
uint32_t          driftSpanS_ = 0;      // baseline length the figure is measured over
uint32_t          syncCount_ = 0;
uint32_t          intervalS_ = DEFAULT_SYNC_INTERVAL_S;
int64_t           firstSyncUs_ = -1;    // esp_timer at the first sync of this boot

constexpr time_t PLAUSIBLE_EPOCH = 1735689600;   // 2025-01-01T00:00:00Z

// Crystal drift: esp_timer measures elapsed time on the local crystal, NTP measures the real
// elapsed time. The difference over a long baseline is the crystal error.
//
// Every division below is OUTSIDE the lock, deliberately. This chip has no FPU, so each double
// operation is a libgcc call in flash costing tens of microseconds, usually cold - and
// portENTER_CRITICAL masks the display scan interrupt for the whole window. Only the stores are
// protected. Reading the baselines unlocked is safe: this callback is their only writer.
void onSync(struct timeval* tv) {                // runs in the lwIP task
  const int64_t now = esp_timer_get_time();
  const int64_t ntpUs = (int64_t)tv->tv_sec * 1000000LL + (int64_t)tv->tv_usec;

  bool  haveLong = false, haveRecent = false, rollMid = false, setBase = false;
  float longPpm = 0.0f, recentPpm = 0.0f;
  uint32_t longSpan = 0, recentSpan = 0;

  if (!haveBase_) {
    setBase = true;
  } else {
    const int64_t dNtp = ntpUs - baseNtpUs_;
    const int64_t dEsp = now - baseEspUs_;
    if (dNtp > 0) {
      const float ppm = (float)((double)(dEsp - dNtp) * 1000000.0 / (double)dNtp);
      // Outside the sanity limit means a bad packet or a stepped clock, not a real rate.
      if (ppm > -DRIFT_PPM_LIMIT && ppm < DRIFT_PPM_LIMIT) {
        longPpm = ppm; longSpan = (uint32_t)(dNtp / 1000000LL); haveLong = true;
      }
    } else {
      // The baseline is ahead of this reply, so it came from a bad packet - SNTP steps the
      // clock to whatever arrives and nothing upstream range-checks it. Left alone this is
      // permanent: dNtp stays negative for the life of the boot and no figure is ever produced
      // again. Re-anchor here instead.
      setBase = true;
    }
    if (haveMid_) {
      const int64_t rNtp = ntpUs - midNtpUs_;
      const int64_t rEsp = now - midEspUs_;
      if (rNtp >= (int64_t)DRIFT_RECENT_MIN_SPAN_S * 1000000LL) {
        const float ppm = (float)((double)(rEsp - rNtp) * 1000000.0 / (double)rNtp);
        if (ppm > -DRIFT_PPM_LIMIT && ppm < DRIFT_PPM_LIMIT) {
          recentPpm = ppm; recentSpan = (uint32_t)(rNtp / 1000000LL); haveRecent = true;
        }
        rollMid = true;
      } else if (rNtp < 0) {
        rollMid = true;
      }
    } else {
      rollMid = true;
    }
  }

  portENTER_CRITICAL(&mux_);
  lastSyncEpoch_ = tv->tv_sec;
  lastSyncUs_ = now;
  if (firstSyncUs_ < 0) firstSyncUs_ = now;
  ++syncCount_;
  if (setBase)    { baseNtpUs_ = ntpUs; baseEspUs_ = now; haveBase_ = true; driftSpanS_ = 0; }
  if (haveLong)   { driftPpm_ = longPpm; driftSpanS_ = longSpan; }
  if (haveRecent) { recentPpm_ = recentPpm; recentSpanS_ = recentSpan; }
  if (rollMid)    { midNtpUs_ = ntpUs; midEspUs_ = now; haveMid_ = true; }
  portEXIT_CRITICAL(&mux_);
}

}  // namespace impl

void setTz(const char* tz) {
  xSemaphoreTake(impl::tzMutex_, portMAX_DELAY);
  std::strncpy(impl::activeTz_, tz, sizeof impl::activeTz_ - 1);
  impl::activeTz_[sizeof impl::activeTz_ - 1] = '\0';
  setenv("TZ", impl::activeTz_, 1);
  tzset();
  xSemaphoreGive(impl::tzMutex_);
}

void begin(const char* ntpServer, const char* tz, uint32_t intervalS) {
  if (!impl::tzMutex_) impl::tzMutex_ = xSemaphoreCreateMutex();
  std::strncpy(impl::server_, ntpServer, sizeof impl::server_ - 1);
  impl::server_[sizeof impl::server_ - 1] = '\0';
  impl::intervalS_ = intervalS;
  setTz(tz);
}

// The configured server for one of our slots, or an empty string if that slot is unused.
const char* slotServer(uint8_t i) {
  if (i == 1) return g_settings.ntpServer2;
  if (i == 2) return g_settings.ntpServer3;
  return g_settings.ntpServer;
}

bool slotUsable(uint8_t i) {
  if (i > 0 && !g_settings.ntpFailover) return false;   // failover off: only slot 0 exists
  return slotServer(i)[0] != '\0';
}

// (Re)start SNTP with exactly ONE server - whichever slot is active - in lwIP slot 0, every
// other slot cleared. lwIP's own selection is round-robin and sticky, so a single timeout on
// the primary would demote it permanently; with no other slot populated its index cannot move
// and the policy is entirely ours. The pointer lwIP keeps is always impl::server_, one buffer
// that outlives every restart, so a settings edit cannot move a string it may be resolving.
void restart() {
  if (esp_sntp_enabled()) esp_sntp_stop();
  esp_sntp_setoperatingmode(ESP_SNTP_OPMODE_POLL);
#if CONFIG_LWIP_DHCP_GET_NTP_SRV
  esp_sntp_servermode_dhcp(false);
#endif
  esp_sntp_setservername(0, impl::server_);
  for (uint8_t i = 1; i < CONFIG_LWIP_SNTP_MAX_SERVERS; ++i)
    esp_sntp_setserver(i, nullptr);                // clears address and name: no fallbacks
  sntp_set_sync_mode(SNTP_SYNC_MODE_IMMED);        // step the clock, do not slew
  sntp_set_sync_interval(impl::intervalS_ * 1000UL);
  sntp_set_time_sync_notification_cb(impl::onSync);
  esp_sntp_init();
}

// Install one of our slots as the single lwIP server.
void selectSlot(uint8_t slot) {
  if (slot >= NTP_SERVER_SLOTS) slot = 0;
  const char* name = slotServer(slot);
  if (name[0] == '\0') { slot = 0; name = slotServer(0); }
  if (name[0] == '\0') return;                     // nothing configured at all
  if (esp_sntp_enabled()) esp_sntp_stop();
  std::strncpy(impl::server_, name, sizeof impl::server_ - 1);
  impl::server_[sizeof impl::server_ - 1] = '\0';
  impl::activeSlot_ = slot;
  impl::slotSinceMs_ = millis();
  portENTER_CRITICAL(&impl::mux_);
  impl::slotSyncCount_ = impl::syncCount_;
  portEXIT_CRITICAL(&impl::mux_);
  restart();
}

uint8_t  activeSlot()    { return impl::activeSlot_; }
uint32_t slotSinceMs()   { return impl::slotSinceMs_; }
uint32_t slotSyncCount() { return impl::slotSyncCount_; }

// The next usable slot after `from`, wrapping. Returns `from` when nothing else is configured,
// so a lone-server setup degenerates into a plain restart rather than a special case.
uint8_t nextUsableSlot(uint8_t from) {
  for (uint8_t step = 1; step <= NTP_SERVER_SLOTS; ++step) {
    const uint8_t cand = (uint8_t)((from + step) % NTP_SERVER_SLOTS);
    if (slotUsable(cand)) return cand;
  }
  return from;
}

// Editing a server is an explicit statement of intent, so it re-anchors on the primary rather
// than leaving the device on a fallback it was sent to before the change.
void setServer(const char* ntpServer) {
  if (esp_sntp_enabled()) esp_sntp_stop();         // stop before the buffer changes
  std::strncpy(impl::server_, ntpServer, sizeof impl::server_ - 1);
  impl::server_[sizeof impl::server_ - 1] = '\0';
  impl::activeSlot_ = 0;
  impl::slotSinceMs_ = millis();
  portENTER_CRITICAL(&impl::mux_);
  impl::slotSyncCount_ = impl::syncCount_;
  portEXIT_CRITICAL(&impl::mux_);
  restart();
}

void setSyncInterval(uint32_t intervalS) {
  impl::intervalS_ = intervalS;
  sntp_set_sync_interval(intervalS * 1000UL);
  if (esp_sntp_enabled()) sntp_restart();          // apply now instead of after the old interval
}

// Immediate poll without changing any setting.
bool syncNow() {
  if (!esp_sntp_enabled()) { restart(); return true; }
  return sntp_restart();
}

bool localNow(std::tm& out, time_t* epoch = nullptr) {
  const time_t now = time(nullptr);
  if (epoch) *epoch = now;
  xSemaphoreTake(impl::tzMutex_, portMAX_DELAY);
  localtime_r(&now, &out);
  xSemaphoreGive(impl::tzMutex_);
  return now >= impl::PLAUSIBLE_EPOCH;
}

void toLocal(time_t epoch, std::tm& out) {
  xSemaphoreTake(impl::tzMutex_, portMAX_DELAY);
  localtime_r(&epoch, &out);
  xSemaphoreGive(impl::tzMutex_);
}

uint32_t syncCount() {
  portENTER_CRITICAL(&impl::mux_);
  const uint32_t n = impl::syncCount_;
  portEXIT_CRITICAL(&impl::mux_);
  return n;
}

bool everSynced() { return syncCount() > 0; }

// Measured crystal drift versus NTP. Valid once the baseline is long enough for the figure to
// beat its own noise. The old gate was 300 s, where a two-point estimate carries about +/- 67 ppm
// of uncertainty - larger than the quantity it measures, which is why a cold boot used to report
// figures like 127 ppm.
bool     driftValid() { return impl::driftSpanS_ >= DRIFT_VALID_SPAN_S; }
float    driftRecentPpm()   { return impl::recentPpm_; }
uint32_t driftRecentSpanS() { return impl::recentSpanS_; }

// One-sigma uncertainty of the current estimate, in ppm. NEGATIVE when nothing has been
// measured at all: returning 0 there reads exactly like a perfectly measured zero.
float driftUncertaintyPpm() {
  const uint32_t span = impl::driftSpanS_;
  if (span == 0) return -1.0f;
  return (2.0f * DRIFT_SYNC_JITTER_US) / (float)span;
}
float    driftPpm()   { return impl::driftPpm_; }
uint32_t driftSpanS() { return impl::driftSpanS_; }

time_t lastSyncEpoch() {
  portENTER_CRITICAL(&impl::mux_);
  const time_t t = impl::lastSyncEpoch_;
  portEXIT_CRITICAL(&impl::mux_);
  return t;
}

int64_t lastSyncAgeUs() {
  portENTER_CRITICAL(&impl::mux_);
  const int64_t t = impl::lastSyncUs_;
  portEXIT_CRITICAL(&impl::mux_);
  return t < 0 ? -1 : esp_timer_get_time() - t;
}

// Milliseconds from start-up to the first sync of this boot, -1 until then.
int32_t firstSyncMs() {
  portENTER_CRITICAL(&impl::mux_);
  const int64_t t = impl::firstSyncUs_;
  portEXIT_CRITICAL(&impl::mux_);
  return t < 0 ? -1 : (int32_t)(t / 1000);
}

uint32_t syncIntervalS() { return impl::intervalS_; }
const char* server() { return impl::server_; }
const char* activeTz() { return impl::activeTz_; }

}  // namespace timekeeping

// ============================================================================ WI-FI CREDENTIALS
//
// Kept in their own NVS namespace, which a factory reset does not clear, so neither a reset nor a
// firmware update can take a clock off its network once it has been saved. Real details in the
// sketch are tried first.

namespace netcfg {

namespace impl {

const char* const NS = "hu058net";
const char* const PLACEHOLDER_SSID = "your-ssid";
char ssid_[33];
char pass_[65];
char savedSsid_[33];
char savedPass_[65];
bool haveSaved_ = false;
bool fromSketch_ = false;
bool usingSaved_ = false;          // sketch details failed repeatedly; trying the saved network

}  // namespace impl

bool sketchHasWifi() {
  return WIFI_SSID[0] != '\0' && std::strcmp(WIFI_SSID, impl::PLACEHOLDER_SSID) != 0;
}

void begin() {
  impl::savedSsid_[0] = impl::savedPass_[0] = '\0';
  Preferences p;
  if (p.begin(impl::NS, true)) {
    // getString returns 0 on any failure and the length with its terminator otherwise, so an
    // empty password (open network) still reads as present.
    if (p.isKey("ssid") && p.isKey("pass") &&
        p.getString("ssid", impl::savedSsid_, sizeof impl::savedSsid_) > 1 &&
        p.getString("pass", impl::savedPass_, sizeof impl::savedPass_) > 0) {
      impl::haveSaved_ = true;
    } else {
      impl::savedSsid_[0] = impl::savedPass_[0] = '\0';
    }
    p.end();
  }
  impl::fromSketch_ = sketchHasWifi();
  if (impl::fromSketch_) {
    util::copyStr(impl::ssid_, sizeof impl::ssid_, WIFI_SSID);
    util::copyStr(impl::pass_, sizeof impl::pass_, WIFI_PASSWORD);
  } else {
    util::copyStr(impl::ssid_, sizeof impl::ssid_, impl::savedSsid_);
    util::copyStr(impl::pass_, sizeof impl::pass_, impl::savedPass_);
  }
  if (impl::fromSketch_) Serial.printf("Wi-Fi %s (from the sketch)\n", impl::ssid_);
  else if (impl::haveSaved_) Serial.printf("Wi-Fi %s (saved from an earlier build)\n", impl::ssid_);
  else Serial.println("ERROR: no Wi-Fi set. Put WIFI_SSID and WIFI_PASSWORD in the sketch and flash over USB.");
}

bool configured() { return impl::ssid_[0] != '\0'; }
bool saved() { return impl::haveSaved_; }
const char* ssid() { return impl::ssid_; }
const char* pass() { return impl::pass_; }

// "sketch", "saved", "fallback" (the sketch network kept failing, the saved one is in use) or "none".
const char* source() {
  if (impl::fromSketch_) return impl::usingSaved_ ? "fallback" : "sketch";
  return impl::haveSaved_ ? "saved" : "none";
}

// Called by the Wi-Fi manager at every radio restart. When the sketch names a different network
// from the saved one and it keeps failing (a typo, a network that has gone), alternate between
// the two, so a bad build cannot strand a clock that had a working network. Once the saved
// network has joined, it stays in use until that link drops or the clock restarts; a restart
// always tries the sketch's network first.
void alternate() {
  if (!impl::fromSketch_ || !impl::haveSaved_) return;
  if (std::strcmp(impl::savedSsid_, WIFI_SSID) == 0 && std::strcmp(impl::savedPass_, WIFI_PASSWORD) == 0) return;
  impl::usingSaved_ = !impl::usingSaved_;
  util::copyStr(impl::ssid_, sizeof impl::ssid_, impl::usingSaved_ ? impl::savedSsid_ : WIFI_SSID);
  util::copyStr(impl::pass_, sizeof impl::pass_, impl::usingSaved_ ? impl::savedPass_ : WIFI_PASSWORD);
  Serial.printf("[wifi] trying %s (%s)\n", impl::ssid_, impl::usingSaved_ ? "saved network" : "from the sketch");
}

// After a successful join with details from the sketch: remember them, unless already saved.
void rememberIfNew() {
  if (!impl::fromSketch_ || impl::usingSaved_) return;
  if (impl::haveSaved_ && std::strcmp(impl::savedSsid_, impl::ssid_) == 0 &&
      std::strcmp(impl::savedPass_, impl::pass_) == 0) return;
  Preferences p;
  panel::pauseForFlash();
  bool ok = p.begin(impl::NS, false);
  if (ok) {
    ok = settings::putStr(p, "ssid", impl::ssid_);
    ok = settings::putStr(p, "pass", impl::pass_) && ok;
    p.end();
  }
  panel::resumeAfterFlash();
  if (!ok) { Serial.println("ERROR: Wi-Fi details could not be saved"); return; }
  util::copyStr(impl::savedSsid_, sizeof impl::savedSsid_, impl::ssid_);
  util::copyStr(impl::savedPass_, sizeof impl::savedPass_, impl::pass_);
  impl::haveSaved_ = true;
  Serial.println("Wi-Fi details saved: builds with the placeholder details keep this network");
}

}  // namespace netcfg

// ============================================================================ WI-FI MANAGER
//
// The device never stops trying to reconnect. Retries back off from WIFI_RETRY_MIN_MS to
// WIFI_RETRY_MAX_MS, and every WIFI_RADIO_RESET_TRIES failures the radio is taken down and
// brought back up, which clears driver states that a plain begin() does not.

namespace wifimgr {

struct Stats {
  uint32_t connects;
  uint32_t disconnects;
  uint32_t retries;
  uint32_t radioResets;
  uint8_t  lastReason;
  uint32_t downSinceMs;     // millis() when the link was last lost, 0 while connected
};

namespace impl {

Stats    stats_ = {};
uint32_t lastAttemptMs_ = 0;
uint32_t retryDelayMs_ = WIFI_RETRY_MIN_MS;
bool     txApplied_ = false;
uint32_t failStreak_ = 0;
volatile bool gotIp_ = false;
volatile int32_t firstIpMs_ = -1;    // millis() at the first IP address of this boot

void onEvent(arduino_event_id_t event, arduino_event_info_t info) {
  switch (event) {
    case ARDUINO_EVENT_WIFI_STA_GOT_IP:
      ++stats_.connects;
      stats_.downSinceMs = 0;
      failStreak_ = 0;
      retryDelayMs_ = WIFI_RETRY_MIN_MS;
      gotIp_ = true;
      if (firstIpMs_ < 0) firstIpMs_ = (int32_t)millis();
      break;
    case ARDUINO_EVENT_WIFI_STA_DISCONNECTED:
      ++stats_.disconnects;
      stats_.lastReason = info.wifi_sta_disconnected.reason;
      if (!stats_.downSinceMs) {
        const uint32_t t = millis();
        stats_.downSinceMs = t ? t : 1;
      }
      break;
    default:
      break;
  }
}

}  // namespace impl

const char* reasonName(uint8_t reason) {
  switch (reason) {
    case 0:   return "none";
    case 1:   return "unspecified";
    case 2:   return "auth expired";
    case 4:   return "association expired";
    case 8:   return "AP dropped us";
    case 15:  return "4-way handshake timeout (check the password)";
    case 200: return "beacon timeout";
    case 201: return "no AP found";
    case 202: return "auth failed";
    case 203: return "association failed";
    case 204: return "handshake timeout";
    case 205: return "connection failed";
    default:  return "see esp_wifi_types.h";
  }
}

// Both knobs revert to their defaults whenever the radio restarts, so this runs after every
// STA start, not once at boot. setTxPower needs the station already started or it refuses.
void applyRadioPower() {
  const wifi_ps_type_t ps = g_settings.wifiPsMode == 2 ? WIFI_PS_MAX_MODEM
                          : g_settings.wifiPsMode == 1 ? WIFI_PS_MIN_MODEM
                                                       : WIFI_PS_NONE;
  WiFi.setSleep(ps);
  esp_wifi_set_ps(ps);
  // 0.25 dBm units. quantiseTxDbm has already snapped the value to a producible step.
  const int8_t q = (int8_t)(g_settings.wifiTxDbm * 4);
  impl::txApplied_ = WiFi.setTxPower((wifi_power_t)q);
}

void begin() {
  WiFi.persistent(false);                 // credentials are kept by netcfg, not the driver
  WiFi.setHostname(g_settings.hostname);  // must precede WiFi.mode()
  WiFi.onEvent(impl::onEvent);
  WiFi.mode(WIFI_STA);
  WiFi.setAutoReconnect(true);
  if (!netcfg::configured()) return;      // nothing to join; loop() stays idle too
  WiFi.begin(netcfg::ssid(), netcfg::pass());
  applyRadioPower();
  const uint32_t t = millis();
  impl::lastAttemptMs_ = t;
  impl::stats_.downSinceMs = t ? t : 1;
}

void loop() {
  const uint32_t now = millis();
  if (!netcfg::configured()) return;
  if (WiFi.isConnected()) {
    impl::retryDelayMs_ = WIFI_RETRY_MIN_MS;
    impl::failStreak_ = 0;
    return;
  }
  if (now - impl::lastAttemptMs_ < impl::retryDelayMs_) return;
  impl::lastAttemptMs_ = now;
  ++impl::stats_.retries;
  ++impl::failStreak_;

  if (impl::failStreak_ % WIFI_RADIO_RESET_TRIES == 0) {
    ++impl::stats_.radioResets;
    WiFi.disconnect(true, false);
    WiFi.mode(WIFI_OFF);
    delay(WIFI_RADIO_OFF_MS);
    WiFi.mode(WIFI_STA);
    netcfg::alternate();
  }
  WiFi.begin(netcfg::ssid(), netcfg::pass());
  applyRadioPower();

  impl::retryDelayMs_ *= 2;
  if (impl::retryDelayMs_ > WIFI_RETRY_MAX_MS) impl::retryDelayMs_ = WIFI_RETRY_MAX_MS;
}

// What the radio reports back, not what we asked for. 0 when the station is not started.
int8_t actualTxDbm() {
  if (!WiFi.isConnected()) return 0;
  const int v = (int)WiFi.getTxPower();
  return (int8_t)(v / 4);
}
bool txApplied() { return impl::txApplied_; }

// True once per new IP; clears the flag.
bool takeGotIp() {
  if (!impl::gotIp_) return false;
  impl::gotIp_ = false;
  return true;
}

void getStats(Stats& out) { out = impl::stats_; }
int32_t firstIpMs() { return impl::firstIpMs_; }
uint32_t retryDelayMs() { return impl::retryDelayMs_; }

uint32_t downSeconds() {
  if (WiFi.isConnected() || !impl::stats_.downSinceMs) return 0;
  return (millis() - impl::stats_.downSinceMs) / 1000;
}

}  // namespace wifimgr

// ============================================================================ CLOCK FACE

namespace clockface {

enum class Mode : uint8_t { TIME, SECONDS, DATE, NUMBER, TEXT, LAMP };

constexpr uint8_t SEQ_MAX = 8;
struct TextStep { char text[5]; uint16_t ms; };

Mode     mode_ = Mode::TIME;
uint32_t modeUntil_ = 0;
int      number_ = 0;
char     unit_ = '\0';
TextStep seq_[SEQ_MAX];
uint8_t  seqLen_ = 0;
uint8_t  seqPos_ = 0;
uint32_t seqStepAt_ = 0;
time_t   lastDateEpoch_ = 0;
bool     blank_ = false;          // OTA in progress
bool     nightActive_ = false;

// Colour state derived from settings. effectRgb_ is written by the cycle effect.
float    gradRgb_[4][9][3];
float    effectRgb_[4][9][3];
float    axisLed_[4][9];
float    axisBlk_[4];
float    envelope_ = 1.0f;
uint32_t effectT0_ = 0;
uint32_t effectAt_ = 0;
bool     colorsDirty_ = true;
uint8_t  lastEffect_ = 0xFF;

uint32_t lifetime(long ms) {
  if (ms < (long)TEMP_MODE_MIN_MS) return TEMP_MODE_MIN_MS;
  if (ms > (long)TEMP_MODE_MAX_MS) return TEMP_MODE_MAX_MS;
  return (uint32_t)ms;
}

void enterMode(Mode m, long ms) {
  mode_ = m;
  modeUntil_ = millis() + lifetime(ms);
  colorsDirty_ = true;                             // lamp test changes colours and current
}

void showSeconds(long ms) { enterMode(Mode::SECONDS, ms); }
void showDate(long ms) { enterMode(Mode::DATE, ms); }
void lampTest(long ms) { enterMode(Mode::LAMP, ms); }

void showNumber(int value, char unit, long ms) {
  number_ = value;
  unit_ = unit;
  enterMode(Mode::NUMBER, ms);
}

// A sequence of up to SEQ_MAX four-character frames, then back to the time.
void showSequence(const char* const* texts, const uint16_t* ms, uint8_t n) {
  if (n == 0) return;
  if (n > SEQ_MAX) n = SEQ_MAX;
  uint32_t total = 0;
  for (uint8_t i = 0; i < n; ++i) {
    util::copyStr(seq_[i].text, sizeof seq_[i].text, texts[i]);
    seq_[i].ms = ms[i] < TEMP_MODE_MIN_MS ? (uint16_t)TEMP_MODE_MIN_MS : ms[i];
    total += seq_[i].ms;
  }
  seqLen_ = n;
  seqPos_ = 0;
  seqStepAt_ = millis() + seq_[0].ms;
  enterMode(Mode::TEXT, (long)total);
}

void showText(const char* text, long ms) {
  const char* t[1] = { text };
  const uint16_t d[1] = { (uint16_t)lifetime(ms > (long)TEXT_SHOW_MAX_MS ? (long)TEXT_SHOW_MAX_MS : ms) };
  showSequence(t, d, 1);
}

// Right-align `s` into a four-character frame.
void rightAlign(const char* s, char out[5]) {
  const size_t n = std::strlen(s);
  std::memset(out, ' ', 4);
  out[4] = '\0';
  const size_t take = n > 4 ? 4 : n;
  std::memcpy(out + (4 - take), s + (n - take), take);
}

// IP address octet by octet, or "no nEt" while Wi-Fi is down.
void showIp() {
  if (!WiFi.isConnected()) {
    const char* t[2] = { "  no", " nEt" };
    const uint16_t d[2] = { NO_NET_SHOW_MS, NO_NET_SHOW_MS };
    showSequence(t, d, 2);
    return;
  }
  const IPAddress ip = WiFi.localIP();
  char octets[4][5];
  const char* texts[5];
  uint16_t ms[5];
  uint8_t n = 0;
  texts[n] = " IP "; ms[n++] = IP_SHOW_HEAD_MS;
  for (int i = 0; i < 4; ++i) {
    char num[5];
    std::snprintf(num, sizeof num, "%u", (unsigned)ip[i]);
    rightAlign(num, octets[i]);
    texts[n] = octets[i]; ms[n++] = IP_SHOW_OCTET_MS;
  }
  showSequence(texts, ms, n);
}

// Time is being kept honestly: link up and a sync within NTP_HEALTH_MULT poll intervals,
// floored at NTP_HEALTH_MIN_S.
bool syncHonest() {
  if (!WiFi.isConnected()) return false;
  const int64_t age = timekeeping::lastSyncAgeUs();
  if (age < 0) return false;
  uint64_t windowS = (uint64_t)timekeeping::syncIntervalS() * NTP_HEALTH_MULT;
  if (windowS < NTP_HEALTH_MIN_S) windowS = NTP_HEALTH_MIN_S;
  return (uint64_t)age <= windowS * 1000000ULL;
}

void setBlank(bool b) {
  blank_ = b;
  if (b) panel::blankNow();
  colorsDirty_ = true;
}

bool inNight(const std::tm& t) {
  if (!g_settings.nightEnabled) return false;
  const uint16_t m = (uint16_t)(t.tm_hour * 60 + t.tm_min);
  const uint16_t a = g_settings.nightStartMin, b = g_settings.nightEndMin;
  if (a == b) return false;
  return a < b ? (m >= a && m < b) : (m >= a || m < b);
}

void markColorsDirty() { colorsDirty_ = true; }

// Recompute everything that depends on settings but not on time: gradient and effect axis.
void settingsChanged() {
  float perLed[4][9], perBlk[4];
  face::projectAxis((float)g_settings.gradAngle, perLed, perBlk);
  for (int b = 0; b < 4; ++b)
    for (int s = 0; s < 9; ++s)
      for (int c = 0; c < 3; ++c) {
        const float a = g_settings.gradA[c] / 255.0f, z = g_settings.gradB[c] / 255.0f;
        gradRgb_[b][s][c] = a + (z - a) * perLed[b][s];
      }
  face::projectAxis((float)g_settings.effectAngle, axisLed_, axisBlk_);
  if (g_settings.effect != lastEffect_) {
    lastEffect_ = g_settings.effect;
    effectT0_ = millis();
    effectAt_ = 0;
    envelope_ = 1.0f;
  }
  colorsDirty_ = true;
}

// Colour of one position before the effect envelope, 0..1 per channel.
void schemeColor(int b, int s, float out[3]) {
  const uint8_t id = face::GEOM[b][s].id;
  switch (g_settings.colorMode) {
    case CM_DIGIT:
      for (int c = 0; c < 3; ++c) out[c] = g_settings.digitRgb[b][c] / 255.0f;
      return;
    case CM_GRADIENT:
      for (int c = 0; c < 3; ++c) out[c] = gradRgb_[b][s][c];
      return;
    case CM_CUSTOM:
      if (id >= 1 && id <= face::LED_COUNT) {
        for (int c = 0; c < 3; ++c) out[c] = g_settings.ledRgb[id - 1][c] / 255.0f;
        return;
      }
      break;
    default:
      break;
  }
  // Solid: normalised so the largest component is full, brightness lives in the current.
  const uint8_t mx = g_settings.rgb[0] > g_settings.rgb[1] ? (g_settings.rgb[0] > g_settings.rgb[2] ? g_settings.rgb[0] : g_settings.rgb[2])
                                                           : (g_settings.rgb[1] > g_settings.rgb[2] ? g_settings.rgb[1] : g_settings.rgb[2]);
  for (int c = 0; c < 3; ++c) out[c] = mx ? (float)g_settings.rgb[c] / (float)mx : 0.0f;
}

void applyColors() {
  if (mode_ == Mode::LAMP) {
    for (auto& blk : panel::level_) for (auto& seg : blk) for (uint8_t& ch : seg) ch = face::COLOR_LEVELS - 1;
  } else {
    for (int b = 0; b < 4; ++b)
      for (int s = 0; s < 9; ++s) {
        float c[3];
        if (g_settings.effect == FX_CYCLE && face::GEOM[b][s].id) { c[0] = effectRgb_[b][s][0]; c[1] = effectRgb_[b][s][1]; c[2] = effectRgb_[b][s][2]; }
        else schemeColor(b, s, c);
        panel::level_[b][s][face::CH_RED]   = face::dutyLevel(c[0] * envelope_);
        panel::level_[b][s][face::CH_GREEN] = face::dutyLevel(c[1] * envelope_);
        panel::level_[b][s][face::CH_BLUE]  = face::dutyLevel(c[2] * envelope_);
      }
  }
  // Current from brightness alone, never from what is lit. Max current is the ceiling everywhere.
  uint8_t want;
  if (mode_ == Mode::LAMP) want = face::currentFor(LAMP_TEST_BRIGHTNESS / 100.0f);
  else {
    const uint8_t pct = nightActive_ && g_settings.nightBrightness ? g_settings.nightBrightness : g_settings.brightness;
    want = face::currentFor(pct / 100.0f);
  }
  panel::is_ = want < g_settings.maxCurrent ? want : g_settings.maxCurrent;
}

void updateEffect(uint32_t nowMs) {
  // Phase in integer milliseconds: a float of elapsed seconds loses sub-second resolution after
  // a few days of uptime and the animation would start to stutter.
  const uint32_t periodMs = (uint32_t)g_settings.effectSpeedDs * 100UL;
  const float period = periodMs / 1000.0f;
  const float phase = (float)((nowMs - effectT0_) % periodMs) / (float)periodMs;
  if (g_settings.effect == FX_FLASH) {
    // Trapezoid: rate and transition time are independent; ramps eat into the halves.
    const float half = period * 0.5f;
    float f = g_settings.flashFadeCs / 100.0f;
    if (f > half) f = half;
    const float t = phase * period;
    float e;
    if (f <= 0.0f) e = t < half ? 1.0f : 0.0f;
    else if (t < f) e = t / f;
    else if (t < half) e = 1.0f;
    else if (t < half + f) e = 1.0f - (t - half) / f;
    else e = 0.0f;
    envelope_ = e;
  } else if (g_settings.effect == FX_CYCLE) {
    envelope_ = 1.0f;
    const float span = g_settings.hueSpan / 360.0f;
    for (int b = 0; b < 4; ++b)
      for (int s = 0; s < 9; ++s) {
        if (!face::GEOM[b][s].id) continue;
        const float t = g_settings.spread == SP_PANEL ? 0.0f : g_settings.spread == SP_DIGIT ? axisBlk_[b] : axisLed_[b][s];
        face::hueRgb(phase + t * span, effectRgb_[b][s]);
      }
  } else {
    envelope_ = 1.0f;
  }
  colorsDirty_ = true;
}

void writeDigit(bool on[4][9], int block, char c) {
  const uint8_t bits = face::glyph(c);
  for (int s = 0; s < 7; ++s) on[block][s] = (bits >> s) & 1;
}

void writeText(bool on[4][9], const char* t) {
  for (int i = 0; i < 4 && t[i]; ++i) writeDigit(on, i, t[i]);
}

// Right aligned, unit in the rightmost position; C and F light the degree mark.
void drawNumber(bool on[4][9], int value, char unit) {
  int pos = 3;
  if (unit != '\0' && face::glyph(unit) != 0) {
    writeDigit(on, 3, unit);
    pos = 2;
    if (unit == 'C' || unit == 'c' || unit == 'F') on[3][face::SEG_ANNUN] = true;
  }
  const bool neg = value < 0;
  long v = neg ? -(long)value : (long)value;
  const int room = pos + 1 - (neg ? 1 : 0);
  long limit = 1;
  for (int i = 0; i < room; ++i) limit *= 10;
  if (v > limit - 1) v = limit - 1;
  do {
    writeDigit(on, pos--, (char)('0' + v % 10));
    v /= 10;
  } while (v > 0 && pos >= 0);
  if (neg && pos >= 0) writeDigit(on, pos, '-');
}

// Clock face dark: switched off, or night mode with night brightness 0.
bool faceOff() {
  return !g_settings.lightOn || (nightActive_ && g_settings.nightBrightness == 0);
}

// Build the face for this instant. Returns into `on`.
void compose(bool on[4][9]) {
  std::memset(on, 0, sizeof(bool) * 4 * 9);
  if (blank_) return;
  if (mode_ == Mode::LAMP) {
    for (int b = 0; b < 4; ++b) for (int s = 0; s < 9; ++s) on[b][s] = face::GEOM[b][s].id != 0;
    return;
  }
  // Explicit temporary displays (button feedback, IP, web actions) show even while the face is
  // switched off or dark for the night; only the normal clock face obeys those.
  if (mode_ == Mode::NUMBER) { drawNumber(on, number_, unit_); return; }
  if (mode_ == Mode::TEXT) { writeText(on, seq_[seqPos_].text); return; }
  if (mode_ == Mode::TIME && faceOff()) return;

  std::tm t;
  const bool valid = timekeeping::localNow(t);
  const bool honest = syncHonest();

  if (!valid) {                                    // no time yet: waiting for the first sync
    writeText(on, "----");
    return;
  }

  if (mode_ == Mode::SECONDS) {
    writeDigit(on, 2, (char)('0' + t.tm_sec / 10));
    writeDigit(on, 3, (char)('0' + t.tm_sec % 10));
    if (!g_settings.colonStatus || honest) on[1][face::SEG_ANNUN] = true;
    on[1][face::SEG_ANNUN2] = true;
    return;
  }

  if (mode_ == Mode::DATE) {
    const int mon = t.tm_mon + 1, day = t.tm_mday;
    const int first = g_settings.dateFormat ? day : mon;
    const int second = g_settings.dateFormat ? mon : day;
    if (first >= 10 || g_settings.leadingZero) writeDigit(on, 0, (char)('0' + first / 10));
    writeDigit(on, 1, (char)('0' + first % 10));
    writeDigit(on, 2, (char)('0' + second / 10));
    writeDigit(on, 3, (char)('0' + second % 10));
    on[2][face::SEG_ANNUN] = true;                 // date dash
    return;
  }

  int hour = t.tm_hour;
  const bool pm = hour >= 12;
  if (g_settings.twelveHour) {
    hour %= 12;
    if (hour == 0) hour = 12;
  }
  if (hour >= 10 || (g_settings.leadingZero && !g_settings.twelveHour)) writeDigit(on, 0, (char)('0' + hour / 10));
  writeDigit(on, 1, (char)('0' + hour % 10));
  writeDigit(on, 2, (char)('0' + t.tm_min / 10));
  writeDigit(on, 3, (char)('0' + t.tm_min % 10));
  // Steady colon when blink is off. With the colon status option on, the upper dot only lights
  // while time is being kept honest, so a lone lower dot means free running on the crystal.
  const bool colon = g_settings.blinkColon ? ((time(nullptr) % 2) == 0) : true;
  if (colon) {
    if (!g_settings.colonStatus || honest) on[1][face::SEG_ANNUN] = true;
    on[1][face::SEG_ANNUN2] = true;
  }
  if (g_settings.twelveHour && !pm) on[0][face::SEG_ANNUN] = true;   // AM mark
}

bool     shown_[4][9];
uint32_t lastComposeMs_ = 0;
time_t   lastSecond_ = 0;

void loop() {
  const uint32_t now = millis();

  if (g_settings.effect != FX_NONE && (int32_t)(now - effectAt_) >= 0) {
    effectAt_ = now + EFFECT_PERIOD_MS;
    updateEffect(now);
  } else if (g_settings.effect == FX_NONE && envelope_ != 1.0f) {
    envelope_ = 1.0f;
    colorsDirty_ = true;
  }

  // The time redraws the moment the second changes, checked every loop pass (a few ms), instead
  // of up to DISPLAY_PERIOD_MS later. That period now only paces temporary displays and night.
  const time_t second = time(nullptr);
  const bool newSecond = second != lastSecond_;
  if (!newSecond && !colorsDirty_ && now - lastComposeMs_ < DISPLAY_PERIOD_MS) return;
  lastSecond_ = second;
  lastComposeMs_ = now;

  // Night window and periodic date need the local time.
  std::tm t;
  time_t epoch = 0;
  const bool valid = timekeeping::localNow(t, &epoch);
  const bool night = valid && inNight(t);
  if (night != nightActive_) { nightActive_ = night; colorsDirty_ = true; }

  if (mode_ == Mode::TEXT && seqPos_ + 1 < seqLen_ && (int32_t)(now - seqStepAt_) >= 0) {
    ++seqPos_;
    seqStepAt_ = now + seq_[seqPos_].ms;
  }
  if (mode_ != Mode::TIME && (int32_t)(now - modeUntil_) >= 0) {
    const bool wasLamp = mode_ == Mode::LAMP;
    mode_ = Mode::TIME;
    if (wasLamp) colorsDirty_ = true;
  }
  if (valid && mode_ == Mode::TIME && !faceOff() && g_settings.dateEveryS && epoch != lastDateEpoch_ &&
      (epoch % g_settings.dateEveryS) == 0) {
    lastDateEpoch_ = epoch;
    showDate(g_settings.dateShowMs);
  }

  bool next[4][9];
  compose(next);
  const bool changed = std::memcmp(next, shown_, sizeof shown_) != 0;
  if (!changed && !colorsDirty_) return;
  if (colorsDirty_) { applyColors(); colorsDirty_ = false; }
  std::memcpy(shown_, next, sizeof shown_);
  std::memcpy(panel::on_, next, sizeof next);
  panel::render();
}

const char* modeName() {
  switch (mode_) {
    case Mode::SECONDS: return "seconds";
    case Mode::DATE:    return "date";
    case Mode::NUMBER:  return "number";
    case Mode::TEXT:    return "text";
    case Mode::LAMP:    return "lamp";
    default:            return "time";
  }
}

bool nightActive() { return nightActive_; }
uint8_t currentStep() { return panel::is_; }

}  // namespace clockface

// ============================================================================ NETWORK SERVICES (mDNS, ArduinoOTA)

namespace services {

bool mdnsStarted_ = false;
bool otaStarted_ = false;
bool otaAdvertised_ = false;

void startOta() {
  ArduinoOTA.setHostname(g_settings.hostname);
  ArduinoOTA.setMdnsEnabled(false);
  if (g_settings.otaPass[0]) ArduinoOTA.setPassword(g_settings.otaPass);
  // handle() blocks for the whole transfer and restarts on success. A pending display change is
  // saved first, then the scan is stopped and the panel dark for the duration, as for every
  // other flash write.
  ArduinoOTA.onStart([] {
    Serial.println("[ota] IDE upload started");
    if (settings::dirty()) settings::save();
    clockface::setBlank(true);
    panel::pauseForFlash();
  });
  ArduinoOTA.onError([](ota_error_t e) {
    Serial.printf("[ota] IDE upload failed (%d)\n", (int)e);
    panel::resumeAfterFlash();
    clockface::setBlank(false);
  });
  ArduinoOTA.begin();
  otaStarted_ = true;
}

// Called on every new IP address. mDNS is started here (NtpClockMod) and ArduinoOTA is told not
// to start its own, so the name is registered once. Either can start on a later address if it
// failed on an earlier one; the IDE upload port is advertised once both are up.
void onGotIp() {
  if (!mdnsStarted_ && MDNS.begin(g_settings.hostname)) {
    MDNS.addService("http", "tcp", 80);
    mdnsStarted_ = true;
  }
  if (!otaStarted_) startOta();
  if (mdnsStarted_ && otaStarted_ && !otaAdvertised_) {
    MDNS.enableArduino(3232, g_settings.otaPass[0] != '\0');
    otaAdvertised_ = true;
  }
}

void loop() {
  if (otaStarted_) ArduinoOTA.handle();
}

// The name mDNS actually answers to: the hostname, or a "-2" style variant if another device
// already had it. Empty until mDNS has started.
const char* mdnsName() {
  static char name[64];
  if (!mdnsStarted_ || mdns_hostname_get(name) != ESP_OK) name[0] = '\0';
  return name;
}

}  // namespace services

// ============================================================================ BUTTONS

namespace buttons {

const uint8_t BRIGHTNESS_STEPS[] = { BRIGHTNESS_STEPS_LIST };

struct Btn {
  uint8_t  pin;
  bool     down;          // debounced, true = pressed
  bool     raw;
  uint32_t rawSinceMs;
  uint32_t downAtMs;
  bool     longFired;
  bool     suppress;      // part of a two-button hold, no single action on release
};

Btn b1_ = { PIN_BTN_1, false, false, 0, 0, false, false };
Btn b2_ = { PIN_BTN_2, false, false, 0, 0, false, false };
bool comboActive_ = false;
uint32_t comboAtMs_ = 0;
int lastCountdown_ = -1;

void begin() {
  // Nothing on the board pulls these up; the stock 8051 used its own port pull-ups.
  pinMode(PIN_BTN_1, INPUT_PULLUP);
  pinMode(PIN_BTN_2, INPUT_PULLUP);
}

// Returns +1 on a debounced press, -1 on a release, 0 otherwise.
int sample(Btn& b, uint32_t now) {
  const bool raw = digitalRead(b.pin) == LOW;
  if (raw != b.raw) { b.raw = raw; b.rawSinceMs = now; }
  if (b.raw != b.down && now - b.rawSinceMs >= BTN_DEBOUNCE_MS) {
    b.down = b.raw;
    if (b.down) { b.downAtMs = now; b.longFired = false; b.suppress = false; return 1; }
    return -1;
  }
  return 0;
}

void feedback(const char* text) { clockface::showText(text, BTN_FEEDBACK_MS); }

void stepBrightness() {
  uint8_t next = BRIGHTNESS_STEPS[0];
  for (uint8_t s : BRIGHTNESS_STEPS) if (s > g_settings.brightness) { next = s; break; }
  g_settings.brightness = next;
  if (!g_settings.lightOn) g_settings.lightOn = 1;
  settings::markDirty();
  clockface::markColorsDirty();
  char txt[8];
  std::snprintf(txt, sizeof txt, "b%3u", (unsigned)next);   // "b  5", "b 50", "b100"
  feedback(txt);
}

void toggleDisplay() {
  g_settings.lightOn = g_settings.lightOn ? 0 : 1;
  settings::markDirty();
  clockface::markColorsDirty();
}

void cycleEffect() {
  g_settings.effect = (uint8_t)((g_settings.effect + 1) % 3);
  settings::markDirty();
  clockface::settingsChanged();
  const char* names[3] = { "EF 0", "EF 1", "EF 2" };
  feedback(names[g_settings.effect]);
}

void loop() {
  const uint32_t now = millis();
  const int e1 = sample(b1_, now);
  const int e2 = sample(b2_, now);

  if (b1_.down && b2_.down) {
    if (!comboActive_) {
      comboActive_ = true;
      comboAtMs_ = now;
      lastCountdown_ = -1;
      b1_.suppress = b2_.suppress = true;
    }
    const uint32_t held = now - comboAtMs_;
    if (held >= BTN_FACTORY_RESET_MS) {
      Serial.println("Factory reset from the buttons");
      clockface::showText("rSt ", (long)RESET_SHOW_MS);
      clockface::loop();
      settings::factoryReset();
      delay(RESET_SHOW_HOLD_MS);
      ESP.restart();
    }
    if (held >= BTN_COMBO_SHOW_MS) {
      uint32_t secs = (BTN_FACTORY_RESET_MS - held + 999) / 1000;
      if (secs > 99) secs = 99;
      const int left = (int)secs;
      if (left != lastCountdown_) {
        lastCountdown_ = left;
        char txt[8];
        std::snprintf(txt, sizeof txt, "rS%2u", (unsigned)secs);
        clockface::showText(txt, (long)COUNTDOWN_FRAME_MS);
      }
    }
    return;
  }
  if (comboActive_) {
    comboActive_ = false;
    if (lastCountdown_ >= 0) clockface::showText("    ", (long)FRAME_CANCEL_MS);   // cancel the countdown frame
  }

  // Long presses fire while held; short presses fire on release.
  if (b1_.down && !b1_.longFired && !b1_.suppress && now - b1_.downAtMs >= BTN_LONG_MS) { b1_.longFired = true; toggleDisplay(); }
  if (b2_.down && !b2_.longFired && !b2_.suppress && now - b2_.downAtMs >= BTN_LONG_MS) { b2_.longFired = true; clockface::showIp(); }
  if (e1 < 0 && !b1_.longFired && !b1_.suppress) stepBrightness();
  if (e2 < 0 && !b2_.longFired && !b2_.suppress) cycleEffect();
}

}  // namespace buttons

// ============================================================================ WEB UI AND API

// WEB_UI_BEGIN
// 35736 bytes of HTML, 12121 bytes gzip.
static const uint8_t INDEX_HTML_GZ[] PROGMEM = {
  0x1f, 0x8b, 0x08, 0x00, 0x00, 0x00, 0x00, 0x00, 0x02, 0xff, 0xb5, 0x7d, 0x6b, 0x7b, 0xdb, 0xb8, 0xae, 0xee, 0xf7, 0xfe,
  0x0a, 0x56, 0x33, 0xab, 0xdb, 0x9e, 0xc8, 0x8a, 0x2f, 0x71, 0x2e, 0x76, 0x9d, 0x9c, 0x34, 0x4d, 0xa7, 0x9d, 0x36, 0x6d,
  0x4f, 0x9d, 0x9e, 0xce, 0x9e, 0x3c, 0xd9, 0x79, 0x64, 0x4b, 0xb6, 0xd5, 0xd8, 0x92, 0x47, 0x92, 0x73, 0x69, 0x9a, 0xff,
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  0x00,
};
static const size_t INDEX_HTML_GZ_LEN = sizeof(INDEX_HTML_GZ);
// WEB_UI_END

const char* resetReasonName(esp_reset_reason_t r) {
  switch (r) {
    case ESP_RST_POWERON:   return "power on";
    case ESP_RST_EXT:       return "external pin";
    case ESP_RST_SW:        return "software restart";
    case ESP_RST_PANIC:     return "panic / exception";
    case ESP_RST_INT_WDT:   return "interrupt watchdog";
    case ESP_RST_TASK_WDT:  return "task watchdog";
    case ESP_RST_WDT:       return "watchdog";
    case ESP_RST_DEEPSLEEP: return "deep sleep wake";
    case ESP_RST_BROWNOUT:  return "brownout";
    case ESP_RST_SDIO:      return "SDIO";
    case ESP_RST_USB:       return "USB reset";
    case ESP_RST_JTAG:      return "JTAG reset";
    case ESP_RST_EFUSE:     return "eFuse error";
    case ESP_RST_PWR_GLITCH:return "power glitch";
    case ESP_RST_CPU_LOCKUP:return "CPU lock-up";
    default:                return "unknown";
  }
}

namespace webui {

namespace impl {

WebServer server(80);
const char* COLLECT_HEADERS[] = { "Origin", "X-Requested-With" };
uint32_t statusServed_ = 0;
bool rebootPending_ = false;
uint32_t rebootAtMs_ = 0;

// Load measurements, updated by loop(): display interrupts per second, the longest loop pass
// over the last 10 s, and how long the last status response took to build.
uint32_t isrPerSec_ = 0;
uint32_t loopMaxUs_ = 0;
uint32_t buildUs_ = 0;

// Minimal JSON writer with string escaping.
class Json {
 public:
  explicit Json(String& out) : s_(out) {}
  Json& open(const char* key = nullptr) { sep(); if (key) name(key); s_ += '{'; first_ = true; return *this; }
  Json& close() { s_ += '}'; first_ = false; return *this; }
  Json& arr(const char* key) { sep(); name(key); s_ += '['; first_ = true; return *this; }
  Json& endArr() { s_ += ']'; first_ = false; return *this; }
  Json& item(const char* v) { sep(); quote(v); return *this; }
  Json& str(const char* key, const char* v) { sep(); name(key); quote(v ? v : ""); return *this; }
  Json& str(const char* key, const String& v) { return str(key, v.c_str()); }
  Json& num(const char* key, long v) { sep(); name(key); s_ += String(v); return *this; }
  Json& unum(const char* key, unsigned long v) { sep(); name(key); s_ += String(v); return *this; }
  Json& real(const char* key, float v, unsigned char dp) { sep(); name(key); if (std::isfinite(v)) s_ += String(v, (unsigned int)dp); else s_ += '0'; return *this; }
  Json& boolean(const char* key, bool v) { sep(); name(key); s_ += v ? "true" : "false"; return *this; }
  Json& null(const char* key) { sep(); name(key); s_ += "null"; return *this; }
  Json& hex(const char* key, const uint8_t rgb[3]) { char h[8]; util::toHex(rgb, h); return str(key, h); }

 private:
  void sep() { if (!first_) s_ += ','; first_ = false; }
  void name(const char* k) { quote(k); s_ += ':'; }
  void quote(const char* v) {
    s_ += '"';
    for (const char* p = v; *p; ++p) {
      const unsigned char c = (unsigned char)*p;
      if (c == '"') s_ += "\\\"";
      else if (c == '\\') s_ += "\\\\";
      else if (c == '\n') s_ += "\\n";
      else if (c < 0x20) { char u[8]; std::snprintf(u, sizeof u, "\\u%04x", c); s_ += u; }
      else s_ += (char)c;
    }
    s_ += '"';
  }
  String& s_;
  bool first_ = true;
};

void sendJson(int code, const String& body) {
  server.sendHeader("Cache-Control", "no-store");
  server.sendHeader("X-Content-Type-Options", "nosniff");
  server.send(code, "application/json", body);
}

void sendError(int code, const char* msg) {
  String out;
  Json(out).open().boolean("ok", false).str("error", msg).close();
  sendJson(code, out);
}

String hostOnly(const String& hostHeader) {
  const int colon = hostHeader.indexOf(':');
  return colon < 0 ? hostHeader : hostHeader.substring(0, colon);
}

// Names this clock answers to: its own name bare, under .local or a common router LAN suffix,
// the name mDNS actually holds (it appends "-2" and so on if another device has the name),
// and its IP address. Anything else is refused, which is what defeats DNS rebinding.
bool nameMatches(const String& h, const String& me) {
  if (me.length() == 0) return false;
  static const char* const SUFFIXES[] = { "", ".local", ".lan", ".home", ".home.arpa", ".localdomain", ".internal" };
  for (const char* suf : SUFFIXES)
    if (h == me + suf) return true;
  return false;
}

bool hostAllowed() {
  String h = hostOnly(server.hostHeader());
  if (h.length() == 0) return false;
  h.toLowerCase();
  if (h.endsWith(".")) h.remove(h.length() - 1);
  String me(g_settings.hostname);
  me.toLowerCase();
  if (nameMatches(h, me)) return true;
  char mdnsName[64];
  if (mdns_hostname_get(mdnsName) == ESP_OK) {
    String m(mdnsName);
    m.toLowerCase();
    if (m != me && nameMatches(h, m)) return true;
  }
  if (h == WiFi.localIP().toString()) return true;
  if (h == "localhost") return true;
  return false;
}

bool authOk() {
  if (g_settings.webUser[0] == '\0') return true;
  if (server.authenticate(g_settings.webUser, g_settings.webPass)) return true;
  server.requestAuthentication();
  return false;
}

// Cross-site request forgery guard for state-changing calls.
bool csrfOk() {
  if (!server.hasHeader("X-Requested-With") || server.header("X-Requested-With") != "HU058Clock") return false;
  if (server.hasHeader("Origin")) {
    const String origin = server.header("Origin");
    const String expect = "http://" + server.hostHeader();
    if (origin != expect) return false;
  }
  return true;
}

bool guard(bool stateChanging) {
  if (!hostAllowed()) { sendError(403, "host not allowed"); return false; }
  if (!authOk()) return false;                       // 401 already sent
  if (stateChanging && !csrfOk()) { sendError(403, "cross-site request rejected"); return false; }
  return true;
}

String fmtTm(const std::tm& tm) {
  char b[40];
  strftime(b, sizeof b, "%Y-%m-%d %H:%M:%S %Z", &tm);
  return String(b);
}

// ---- firmware update record (namespace hu058sys, survives a factory reset)
// "in progress" when an upload starts, then the result. A record still "in progress" at boot
// means the clock restarted mid-upload, reported with the reset reason.
enum : uint8_t { OTA_NONE = 0, OTA_RUNNING = 1, OTA_DONE = 2, OTA_FAILED = 3 };
struct OtaRecord {
  uint8_t  state;
  uint32_t bytes;
  char     text[96];
};
OtaRecord ota_;

void saveOta() {
  Preferences p;
  panel::pauseForFlash();
  if (p.begin("hu058sys", false)) {
    p.putBytes("ota", &ota_, sizeof ota_);
    p.end();
  }
  panel::resumeAfterFlash();
}

void setOta(uint8_t state, uint32_t bytes, const char* text) {
  ota_.state = state;
  ota_.bytes = bytes;
  util::copyStr(ota_.text, sizeof ota_.text, text);
  Serial.printf("[ota] %s\n", ota_.text);
  saveOta();
}

bool uploadOk_ = false;
bool uploadRejected_ = false;
bool uploadPaused_ = false;        // this upload stopped the scan and blanked the panel
String uploadError_;

void uploadResume() {
  if (!uploadPaused_) return;
  uploadPaused_ = false;
  panel::resumeAfterFlash();
  clockface::setBlank(false);
}

void handleRoot() {
  if (!guard(false)) return;
  server.sendHeader("Cache-Control", "no-store");
  server.sendHeader("X-Content-Type-Options", "nosniff");
  server.sendHeader("Content-Encoding", "gzip");
  server.send_P(200, "text/html; charset=utf-8", (PGM_P)INDEX_HTML_GZ, INDEX_HTML_GZ_LEN);
}

// The page's poll. Reused buffer: a fresh String per poll for hours fragments the heap.
void handleStatus() {
  if (!guard(false)) return;
  const int64_t buildStart = esp_timer_get_time();
  wifimgr::Stats ws;
  wifimgr::getStats(ws);
  const int64_t nowUs = esp_timer_get_time();
  const bool up = WiFi.isConnected();

  static String out;
  out.remove(0);
  out.reserve(JSON_RESERVE);
  Json j(out);
  j.open().boolean("ok", true);
  j.open("status");
  j.str("version", FW_VERSION).unum("uptime_s", (unsigned long)(nowUs / 1000000));

  std::tm now;
  time_t epoch = 0;
  const bool timeOk = timekeeping::localNow(now, &epoch);
  j.boolean("time_valid", timeOk);
  if (timeOk) {
    char b[40];
    strftime(b, sizeof b, "%Y-%m-%d %H:%M:%S", &now);
    j.str("local", b);
    strftime(b, sizeof b, "%z %Z", &now);
    j.str("zone", b);
    j.boolean("dst_now", now.tm_isdst > 0);
  } else {
    j.str("local", "").str("zone", "").boolean("dst_now", false);
  }
  j.str("tz_active", timekeeping::activeTz());

  // ---- NTP, NtpClockMod fields
  const int64_t age = timekeeping::lastSyncAgeUs();
  j.open("ntp").str("server", timekeeping::server()).boolean("synced", timekeeping::everSynced())
      .unum("sync_count", timekeeping::syncCount()).unum("interval_s", timekeeping::syncIntervalS())
      .num("active_slot", (long)timekeeping::activeSlot())
      .str("active_role", timekeeping::activeSlot() == 0 ? "primary" : "fallback")
      .boolean("failover", g_settings.ntpFailover)
      .boolean("healthy", clockface::syncHonest())
      .num("first_sync_ms", timekeeping::firstSyncMs());
  j.boolean("drift_measured", timekeeping::driftSpanS() > 0)
      .real("drift_ppm_err", timekeeping::driftUncertaintyPpm(), 2)
      .real("drift_recent_ppm", timekeeping::driftRecentPpm(), 2)
      .unum("drift_recent_span_s", timekeeping::driftRecentSpanS());
  j.boolean("drift_valid", timekeeping::driftValid())
      .real("drift_ppm", timekeeping::driftPpm(), 2)
      .unum("drift_span_s", timekeeping::driftSpanS())
      .unum("drift_need_s", DRIFT_VALID_SPAN_S);
  if (age >= 0) {
    std::tm tm;
    timekeeping::toLocal(timekeeping::lastSyncEpoch(), tm);
    j.str("last_sync", fmtTm(tm)).num("last_sync_age_s", (long)(age / 1000000));
  } else {
    j.null("last_sync").num("last_sync_age_s", -1);
  }
  j.close();

  // ---- Wi-Fi, NtpClockMod fields
  j.open("wifi").boolean("connected", up).str("ssid", netcfg::ssid()).str("wifi_source", netcfg::source())
      .boolean("wifi_saved", netcfg::saved())
      .str("host", g_settings.hostname).str("mdns_name", services::mdnsName())
      .unum("connects", ws.connects).unum("disconnects", ws.disconnects)
      .unum("retries", ws.retries).unum("radio_resets", ws.radioResets)
      .num("last_reason", (long)ws.lastReason).str("last_reason_text", wifimgr::reasonName(ws.lastReason))
      .unum("down_s", wifimgr::downSeconds()).unum("retry_ms", wifimgr::retryDelayMs())
      .num("tx_dbm", (long)g_settings.wifiTxDbm)
      .num("tx_dbm_actual", (long)wifimgr::actualTxDbm())
      .boolean("tx_applied", wifimgr::txApplied())
      .num("ps_mode", (long)g_settings.wifiPsMode)
      .num("first_ip_ms", wifimgr::firstIpMs());
  if (up) j.num("rssi", WiFi.RSSI()).str("ip", WiFi.localIP().toString());
  else j.num("rssi", 0).str("ip", "");
  j.close();

  // ---- display
  j.open("display").str("mode", clockface::modeName()).boolean("night_active", clockface::nightActive())
      .num("current_step", clockface::currentStep())
      .unum("current_ma_x10", face::IS_MA[clockface::currentStep()])
      .boolean("scan_ok", panel::timerOk())
      .boolean("save_pending", settings::dirty()).boolean("save_ok", settings::lastSaveOk())
      .close();

  // ---- system
  const esp_partition_t* run = esp_ota_get_running_partition();
  const esp_partition_t* nxt = esp_ota_get_next_update_partition(nullptr);
  j.open("sys").str("reset_reason", resetReasonName(g_resetReason)).num("reset_code", (long)g_resetReason)
      .unum("boot_count", (unsigned long)g_bootCount)
      .unum("heap_free", (unsigned long)ESP.getFreeHeap())
      .unum("heap_largest", (unsigned long)heap_caps_get_largest_free_block(MALLOC_CAP_8BIT))
      .unum("heap_min", (unsigned long)ESP.getMinFreeHeap())
      .unum("isr_per_s", isrPerSec_).unum("loop_max_us", loopMaxUs_).unum("build_us", buildUs_)
      .unum("scan_steps", panel::steps()).unum("isr_early", panel::earlyCount()).unum("isr_late", panel::lateCount())
      .str("slot_running", run ? run->label : "").str("slot_next", nxt ? nxt->label : "")
      .unum("slot_next_kb", nxt ? (unsigned long)(nxt->size / 1024) : 0UL)
      .num("ota_state", ota_.state).str("ota_last", ota_.text)
      .unum("status_served", statusServed_)
      .close();
  j.close();
  j.close();
  ++statusServed_;
  buildUs_ = (uint32_t)(esp_timer_get_time() - buildStart);
  sendJson(200, out);
}

void buildConfig(Json& j) {
  const Settings& s = g_settings;
  j.open("settings");
  j.boolean("on", s.lightOn).num("bri", s.brightness).num("maxi", s.maxCurrent).hex("color", s.rgb)
      .boolean("h12", s.twelveHour).boolean("blink", s.blinkColon).boolean("lz", s.leadingZero)
      .num("colon", s.colonStatus).num("cmode", s.colorMode);
  j.arr("digits");
  for (int i = 0; i < 4; ++i) { char h[8]; util::toHex(s.digitRgb[i], h); j.item(h); }
  j.endArr();
  j.hex("ga", s.gradA).hex("gb", s.gradB).num("gang", s.gradAngle);
  j.arr("leds");
  for (int i = 0; i < 33; ++i) { char h[8]; util::toHex(s.ledRgb[i], h); j.item(h); }
  j.endArr();
  j.num("fx", s.effect).num("spread", s.spread).num("fxang", s.effectAngle).num("hue", s.hueSpan)
      .real("speed", s.effectSpeedDs / 10.0f, 1).real("fade", s.flashFadeCs / 100.0f, 2)
      .num("dateevery", s.dateEveryS).num("dateshow", s.dateShowMs).num("datefmt", s.dateFormat)
      .boolean("night", s.nightEnabled).num("nstart", s.nightStartMin).num("nend", s.nightEndMin)
      .num("nbri", s.nightBrightness);
  j.str("host", s.hostname).str("wuser", s.webUser)
      .boolean("wpwd_set", s.webPass[0] != '\0').boolean("otapw_set", s.otaPass[0] != '\0');
  j.str("ntp1", s.ntpServer).str("ntp2", s.ntpServer2).str("ntp3", s.ntpServer3)
      .boolean("failover", s.ntpFailover).unum("interval", s.syncIntervalS)
      .str("tz", s.tz).num("dst", s.dstMode).num("tx", s.wifiTxDbm).num("ps", s.wifiPsMode);
  j.close();
}

// Settings for the form: fetched once at page load, and returned by every change.
void handleConfig() {
  if (!guard(false)) return;
  String out;
  out.reserve(JSON_RESERVE);
  Json j(out);
  j.open().boolean("ok", true);
  buildConfig(j);
  j.close();
  sendJson(200, out);
}

// Validate every supplied field into a copy, then apply all or nothing. Time and radio changes
// are saved at once (NtpClockMod); display changes are saved 5 s after the last one.
void handleSettings() {
  if (!guard(true)) return;
  if (settings::resetPending()) { sendError(503, "Factory reset in progress, restarting"); return; }
  Settings n = g_settings;
  const char* err = nullptr;
  long v = 0;
  bool b = false;
  bool display = false;

  auto has = [](const char* k) { return server.hasArg(k); };
  auto arg = [](const char* k) { return server.arg(k); };
  auto boolArg = [&](const char* k, uint8_t& dst, const char* msg) {
    if (err || !has(k)) return;
    if (!util::parseBool(arg(k).c_str(), b)) { err = msg; return; }
    dst = b ? 1 : 0;
    display = true;
  };
  auto intArg = [&](const char* k, long lo, long hi, const char* msg, long& dst) -> bool {
    if (err || !has(k)) return false;
    if (!util::parseLong(arg(k).c_str(), lo, hi, dst)) { err = msg; return false; }
    return true;
  };
  auto colorArg = [&](const char* k, uint8_t dst[3], const char* msg) {
    if (err || !has(k)) return;
    if (!util::parseHex(arg(k).c_str(), dst)) err = msg;
    display = true;
  };

  boolArg("on", n.lightOn, "on: 0 or 1");
  if (intArg("bri", 1, 100, "Brightness: 1 to 100", v)) { n.brightness = (uint8_t)v; display = true; }
  if (intArg("maxi", 0, 15, "Max current: 0 to 15", v)) { n.maxCurrent = (uint8_t)v; display = true; }
  colorArg("color", n.rgb, "Colour: #RRGGBB");
  boolArg("h12", n.twelveHour, "Time format: 0 = 24 hour, 1 = 12 hour");
  boolArg("blink", n.blinkColon, "Blink colon: 0 or 1");
  boolArg("lz", n.leadingZero, "Leading zero: 0 or 1");
  if (intArg("colon", 0, 1, "Colon: 0 both dots blink, 1 upper dot shows sync status", v)) { n.colonStatus = (uint8_t)v; display = true; }
  if (intArg("cmode", 0, 3, "Colour mode: 0 to 3", v)) { n.colorMode = (uint8_t)v; display = true; }
  colorArg("d0", n.digitRgb[0], "Digit 1 colour: #RRGGBB");
  colorArg("d1", n.digitRgb[1], "Digit 2 colour: #RRGGBB");
  colorArg("d2", n.digitRgb[2], "Digit 3 colour: #RRGGBB");
  colorArg("d3", n.digitRgb[3], "Digit 4 colour: #RRGGBB");
  colorArg("ga", n.gradA, "Gradient start: #RRGGBB");
  colorArg("gb", n.gradB, "Gradient end: #RRGGBB");
  if (intArg("gang", -180, 180, "Gradient angle: -180 to 180", v)) { n.gradAngle = (int16_t)v; display = true; }
  if (!err && has("leds")) {
    const String l = arg("leds");
    if (l.length() != 33 * 6) err = "leds: 33 colours of 6 hex digits";
    for (int i = 0; i < 33 && !err; ++i) {
      char h[7];
      std::memcpy(h, l.c_str() + i * 6, 6);
      h[6] = '\0';
      if (!util::parseHex(h, n.ledRgb[i])) err = "leds: invalid hex colour";
    }
    display = true;
  }
  if (intArg("fx", 0, 2, "Effect: 0 to 2", v)) { n.effect = (uint8_t)v; display = true; }
  if (intArg("spread", 0, 2, "Spread: 0 to 2", v)) { n.spread = (uint8_t)v; display = true; }
  if (intArg("fxang", -180, 180, "Effect angle: -180 to 180", v)) { n.effectAngle = (int16_t)v; display = true; }
  if (intArg("hue", 0, 360, "Hue span: 0 to 360", v)) { n.hueSpan = (uint16_t)v; display = true; }
  if (!err && has("speed")) {
    if (util::parseScaled(arg("speed").c_str(), 10, 2, 6000, v)) { n.effectSpeedDs = (uint16_t)v; display = true; }
    else err = "Effect speed: 0.2 to 600 seconds";
  }
  if (!err && has("fade")) {
    if (util::parseScaled(arg("fade").c_str(), 100, 0, 3000, v)) { n.flashFadeCs = (uint16_t)v; display = true; }
    else err = "Flash fade: 0 to 30 seconds";
  }
  if (intArg("dateevery", 0, 3600, "Date every: 0 or 10 to 3600 seconds", v)) {
    if (v != 0 && v < 10) err = "Date every: 0 or 10 to 3600 seconds";
    else { n.dateEveryS = (uint16_t)v; display = true; }
  }
  if (intArg("dateshow", 500, 10000, "Date shown for: 500 to 10000 ms", v)) { n.dateShowMs = (uint16_t)v; display = true; }
  if (intArg("datefmt", 0, 1, "Date format: 0 or 1", v)) { n.dateFormat = (uint8_t)v; display = true; }
  boolArg("night", n.nightEnabled, "Night mode: 0 or 1");
  if (intArg("nstart", 0, 1439, "Night start: 0 to 1439 minutes", v)) { n.nightStartMin = (uint16_t)v; display = true; }
  if (intArg("nend", 0, 1439, "Night end: 0 to 1439 minutes", v)) { n.nightEndMin = (uint16_t)v; display = true; }
  if (intArg("nbri", 0, 100, "Night brightness: 0 to 100", v)) { n.nightBrightness = (uint8_t)v; display = true; }

  // ---- time and radio (NtpClockMod rules)
  if (!err && has("ntp1")) {
    String s = arg("ntp1"); s.trim();
    if (!settings::validNtpServer(s.c_str())) err = "NTP server: hostname or IPv4 address (letters, digits, dots, hyphens; max 63)";
    else util::copyStr(n.ntpServer, sizeof n.ntpServer, s.c_str());
  }
  if (!err && has("ntp2")) {
    String s = arg("ntp2"); s.trim();
    if (s.length() && !settings::validNtpServer(s.c_str())) err = "NTP fallback 1: hostname or IPv4 address, or empty to disable";
    else util::copyStr(n.ntpServer2, sizeof n.ntpServer2, s.c_str());
  }
  if (!err && has("ntp3")) {
    String s = arg("ntp3"); s.trim();
    if (s.length() && !settings::validNtpServer(s.c_str())) err = "NTP fallback 2: hostname or IPv4 address, or empty to disable";
    else util::copyStr(n.ntpServer3, sizeof n.ntpServer3, s.c_str());
  }
  if (!err && has("failover")) {
    if (!util::parseBool(arg("failover").c_str(), b)) err = "Failover: 0 or 1";
    else n.ntpFailover = b;
  }
  if (!err && has("wuser")) {
    String u = arg("wuser");
    if (!settings::validUser(u.c_str())) err = "Web login name: up to 32 printable characters, no ':'";
    else util::copyStr(n.webUser, sizeof n.webUser, u.c_str());
  }
  if (!err && has("wpwd")) {
    String w = arg("wpwd");
    if (!settings::validPassword(w.c_str())) err = "Web login password: up to 64 printable characters";
    else util::copyStr(n.webPass, sizeof n.webPass, w.c_str());
  }
  if (!err && n.webUser[0] && !n.webPass[0]) err = "Web login: a name needs a password";
  if (!err && !n.webUser[0]) n.webPass[0] = '\0';
  if (!err && has("otapw")) {
    String w = arg("otapw");
    if (!settings::validPassword(w.c_str())) err = "Upload password: up to 64 printable characters";
    else util::copyStr(n.otaPass, sizeof n.otaPass, w.c_str());
  }
  if (!err && has("host")) {
    String h = arg("host"); h.trim(); h.toLowerCase();
    if (h != g_settings.hostname && !settings::validHostname(h.c_str(), 31))
      err = "Hostname: 1 to 31 of a-z, 0-9 and -, not starting or ending with -";
    else util::copyStr(n.hostname, sizeof n.hostname, h.c_str());
  }
  if (!err && has("tz")) {
    String s = arg("tz"); s.trim();
    if (!settings::validTz(s.c_str())) err = "Time zone: POSIX TZ rule, for example EST5EDT,M3.2.0,M11.1.0";
    else util::copyStr(n.tz, sizeof n.tz, s.c_str());
  }
  if (intArg("interval", (long)NTP_MIN_INTERVAL_S, (long)NTP_MAX_INTERVAL_S, "Poll interval: 15 to 86400 seconds", v))
    n.syncIntervalS = (uint32_t)v;
  if (intArg("dst", 0, 2, "Daylight saving: 0 auto, 1 standard all year, 2 daylight all year", v)) n.dstMode = (uint8_t)v;
  if (intArg("tx", 2, 20, "Wi-Fi TX power: 2 to 20 dBm", v)) n.wifiTxDbm = settings::quantiseTxDbm((int)v);
  if (intArg("ps", 0, 2, "Wi-Fi sleep mode: 0, 1 or 2", v)) n.wifiPsMode = (uint8_t)v;
  if (err) { sendError(400, err); return; }

  const bool ntpChanged = std::strcmp(n.ntpServer, g_settings.ntpServer) != 0 ||
                          std::strcmp(n.ntpServer2, g_settings.ntpServer2) != 0 ||
                          std::strcmp(n.ntpServer3, g_settings.ntpServer3) != 0;
  const bool foOff = g_settings.ntpFailover && !n.ntpFailover;
  const bool tzChanged = std::strcmp(n.tz, g_settings.tz) != 0 || n.dstMode != g_settings.dstMode;
  const bool ivalChanged = n.syncIntervalS != g_settings.syncIntervalS;
  const bool radioChanged = n.wifiTxDbm != g_settings.wifiTxDbm || n.wifiPsMode != g_settings.wifiPsMode;
  // A new name or upload password takes a restart: DHCP, mDNS and the IDE upload port all take
  // them at start-up, and ArduinoOTA cannot drop a password once set.
  const bool restartNeeded = std::strcmp(n.hostname, g_settings.hostname) != 0 ||
                           std::strcmp(n.otaPass, g_settings.otaPass) != 0;
  const bool loginChanged = std::strcmp(n.webUser, g_settings.webUser) != 0 ||
                            std::strcmp(n.webPass, g_settings.webPass) != 0;
  const bool timeOrRadio = ntpChanged || foOff || n.ntpFailover != g_settings.ntpFailover || tzChanged || ivalChanged || radioChanged || restartNeeded || loginChanged;
  const Settings before = g_settings;

  g_settings = n;
  // Turning failover off while parked on a fallback must not strand the device there.
  if (foOff && timekeeping::activeSlot() != 0) timekeeping::selectSlot(0);
  // Applied in place, no reconnect: dropping TX power must not drop the link answering this.
  if (radioChanged) wifimgr::applyRadioPower();
  if (tzChanged) {
    char active[64];
    settings::effectiveTz(active, sizeof active);
    timekeeping::setTz(active);
  }
  if (ivalChanged) timekeeping::setSyncInterval(g_settings.syncIntervalS);
  if (ntpChanged) timekeeping::setServer(g_settings.ntpServer);
  if (display) clockface::settingsChanged();

  bool saved = true;
  if (timeOrRadio) saved = settings::save();
  else if (display) settings::markDirty();
  if (!saved) settings::markDirty();               // retried every SETTINGS_SAVE_DELAY_MS
  // Restart only once the new name is safely stored; otherwise keep answering to the old one.
  bool restarting = false;
  if (restartNeeded) {
    if (saved) {
      restarting = true;
      rebootPending_ = true;
      rebootAtMs_ = millis() + RESTART_DELAY_MS;
    } else {
      // Not stored: keep answering to the old name, password and login.
      util::copyStr(g_settings.hostname, sizeof g_settings.hostname, before.hostname);
      util::copyStr(g_settings.otaPass, sizeof g_settings.otaPass, before.otaPass);
    }
  }
  if (loginChanged && !saved) {
    util::copyStr(g_settings.webUser, sizeof g_settings.webUser, before.webUser);
    util::copyStr(g_settings.webPass, sizeof g_settings.webPass, before.webPass);
  }
  // A failed save may have written some keys and not others. Write the restored name and
  // passwords straight back, so storage can never hold a login or name nobody set.
  bool consistent = true;
  if (!saved && (restartNeeded || loginChanged)) consistent = settings::save();

  String out;
  out.reserve(JSON_RESERVE);
  Json j(out);
  j.open().boolean("ok", saved).boolean("restart", restarting);
  if (!saved) j.str("error", !(restartNeeded || loginChanged)
                                 ? "Saving failed: the changes are active and the clock keeps trying to save them"
                                 : consistent ? "Saving the name, login or upload password failed, so they are unchanged; the other changes are saved"
                                              : "Saving failed: the changes are active and the clock keeps trying to save them. If it restarts first, check the name and login");
  buildConfig(j);
  j.close();
  sendJson(saved ? 200 : 500, out);
}

void handleAction() {
  if (!guard(true)) return;
  const String a = server.arg("a");
  long ms = (long)ACTION_SHOW_MS;
  if (server.hasArg("ms") && !util::parseLong(server.arg("ms").c_str(), (long)TEMP_MODE_MIN_MS, (long)TEMP_MODE_MAX_MS, ms)) {
    sendError(400, "ms: 100 to 600000");
    return;
  }
  if (a == "lamp") {
    clockface::lampTest(server.hasArg("ms") ? ms : (long)LAMP_TEST_MS);
  } else if (a == "seconds") {
    clockface::showSeconds(ms);
  } else if (a == "date") {
    clockface::showDate(server.hasArg("ms") ? ms : g_settings.dateShowMs);
  } else if (a == "ip") {
    clockface::showIp();
  } else if (a == "number") {
    long value = 0;
    if (!util::parseLong(server.arg("value").c_str(), -999, 9999, value)) { sendError(400, "Number: -999 to 9999"); return; }
    const String unit = server.arg("unit");
    if (unit.length() > 1) { sendError(400, "Unit: one character or empty"); return; }
    clockface::showNumber((int)value, unit.length() ? unit[0] : '\0', ms);
  } else if (a == "text") {
    const String text = server.arg("text");
    if (text.length() > 4 || !util::printable(text.c_str())) { sendError(400, "Text: up to 4 characters"); return; }
    clockface::showText(text.c_str(), ms);
  } else if (a == "sync") {
    if (!timekeeping::syncNow()) { sendError(503, "SNTP not running yet"); return; }
  } else if (a == "reboot") {
    if (settings::dirty()) settings::save();
    rebootPending_ = true;
    rebootAtMs_ = millis() + RESTART_DELAY_MS;
  } else if (a == "factory") {
    const bool cleared = settings::factoryReset();
    rebootPending_ = true;                           // restart either way: nothing more is saved
    rebootAtMs_ = millis() + RESTART_DELAY_MS;
    if (!cleared) { sendError(500, "Factory reset failed: settings could not be cleared. Restarting."); return; }
  } else {
    sendError(400, "Unknown action");
    return;
  }
  String out;
  Json(out).open().boolean("ok", true).close();
  sendJson(200, out);
}

// Lightweight liveness probe (NtpClockMod).
void handlePing() {
  if (!guard(false)) return;
  String out;
  Json(out).open().boolean("ok", true).str("version", FW_VERSION)
      .unum("uptime_s", (unsigned long)(esp_timer_get_time() / 1000000))
      .unum("heap", (unsigned long)ESP.getFreeHeap())
      .unum("status_served", statusServed_).close();
  sendJson(200, out);
}

// Firmware upload: Espressif's WebUpdate example sequence (Update.begin with the slot size,
// write each chunk, Update.end(true)), with the host and CSRF checks above and a record of
// every attempt. The display scan is stopped and the panel dark for the whole write.
void handleUploadChunk() {
  // The core also calls this for a POST with a plain body, where upload() is a placeholder.
  if (!server.hasUpload()) return;
  HTTPUpload& up = server.upload();
  char t[96];
  if (up.status == UPLOAD_FILE_START) {
    if (uploadOk_ || uploadPaused_) {
      // A second file part in one request: the first is already written or in progress.
      uploadRejected_ = true;
      uploadError_ = "one firmware file per upload";
      return;
    }
    uploadError_ = "";
    uploadRejected_ = !hostAllowed() || (g_settings.webUser[0] && !server.authenticate(g_settings.webUser, g_settings.webPass)) || !csrfOk();
    if (uploadRejected_) { uploadError_ = "upload not authorised"; Serial.println("[ota] upload rejected: not authorised"); return; }
    const esp_partition_t* next = esp_ota_get_next_update_partition(nullptr);
    if (!next) {
      uploadError_ = "No update slot: flashed with a partition scheme without OTA. Flash once over USB with Default 4MB with spiffs.";
      uploadRejected_ = true;
      setOta(OTA_FAILED, 0, "Failed: no update slot in the partition table");
      return;
    }
    if (Update.isRunning()) Update.abort();
    if (settings::dirty()) settings::save();         // before the long pause
    clockface::setBlank(true);
    panel::pauseForFlash();                          // held until the upload ends or fails
    uploadPaused_ = true;
    std::snprintf(t, sizeof t, "Started: %s into %s (%lu KB slot)", up.filename.c_str(), next->label, (unsigned long)(next->size / 1024));
    setOta(OTA_RUNNING, 0, t);
    if (!Update.begin(UPDATE_SIZE_UNKNOWN, U_FLASH)) {
      uploadError_ = Update.errorString();
      uploadRejected_ = true;
      uploadResume();
      std::snprintf(t, sizeof t, "Failed to start: %s", uploadError_.c_str());
      setOta(OTA_FAILED, 0, t);
    }
  } else if (up.status == UPLOAD_FILE_WRITE) {
    if (uploadRejected_) return;
    const uint32_t before = up.totalSize;
    if (Update.write(up.buf, up.currentSize) != up.currentSize) {
      uploadError_ = Update.errorString();
      uploadRejected_ = true;
      Update.abort();
      uploadResume();
      std::snprintf(t, sizeof t, "Failed writing at %lu KB: %s", (unsigned long)(before / 1024), uploadError_.c_str());
      setOta(OTA_FAILED, before, t);
      return;
    }
    if ((before + up.currentSize) / OTA_LOG_STEP_BYTES != before / OTA_LOG_STEP_BYTES)
      Serial.printf("[ota] %lu KB received\n", (unsigned long)((before + up.currentSize) / 1024));
  } else if (up.status == UPLOAD_FILE_END) {
    if (uploadRejected_) return;
    if (Update.end(true)) {
      uploadOk_ = true;
      std::snprintf(t, sizeof t, "Succeeded: %lu KB written, replacing %s", (unsigned long)(up.totalSize / 1024), FW_VERSION);
      setOta(OTA_DONE, up.totalSize, t);
    } else {
      uploadError_ = Update.errorString();
      uploadRejected_ = true;
      uploadResume();
      std::snprintf(t, sizeof t, "Failed at the end (%lu KB): %s", (unsigned long)(up.totalSize / 1024), uploadError_.c_str());
      setOta(OTA_FAILED, up.totalSize, t);
    }
  } else if (up.status == UPLOAD_FILE_ABORTED) {
    // The web server closes the connection without an answer after this, so the browser only
    // sees a network error: the record is how the reason reaches the page.
    if (uploadOk_) {
      // The image was complete and verified; only the reply was lost. Finish as on success.
      Serial.println("[ota] connection closed after a complete upload, restarting");
      rebootPending_ = true;
      rebootAtMs_ = millis() + RESTART_DELAY_MS;
      return;
    }
    const uint32_t got = up.totalSize + up.currentSize;
    if (uploadPaused_ && !uploadRejected_) {
      Update.abort();
      std::snprintf(t, sizeof t, "Failed: connection lost or stalled 5 s after %lu KB", (unsigned long)(got / 1024));
      setOta(OTA_FAILED, got, t);
    }
    uploadRejected_ = true;
    uploadError_ = "upload aborted";
    uploadResume();
  }
}

void handleUploadDone() {
  if (!hostAllowed()) { sendError(403, "host not allowed"); return; }
  if (g_settings.webUser[0] && !server.authenticate(g_settings.webUser, g_settings.webPass)) { server.requestAuthentication(); return; }
  if (!uploadOk_) { sendError(400, uploadError_.length() ? uploadError_.c_str() : "no firmware received"); return; }
  if (settings::dirty()) settings::save();
  String out;
  Json(out).open().boolean("ok", true).str("message", "Firmware written, restarting").close();
  server.sendHeader("Connection", "close");
  sendJson(200, out);
  rebootPending_ = true;
  rebootAtMs_ = millis() + RESTART_DELAY_MS;
}

}  // namespace impl

// At boot: load the last update record and resolve one that never finished.
void loadOta() {
  std::memset(&impl::ota_, 0, sizeof impl::ota_);
  Preferences p;
  if (p.begin("hu058sys", true)) {
    if (p.getBytesLength("ota") == sizeof impl::ota_) p.getBytes("ota", &impl::ota_, sizeof impl::ota_);
    p.end();
  }
  impl::ota_.text[sizeof impl::ota_.text - 1] = '\0';
  if (impl::ota_.state == impl::OTA_RUNNING) {
    char t[96];
    std::snprintf(t, sizeof t, "Failed: the clock restarted during the upload (reset reason: %s)",
                  resetReasonName(g_resetReason));
    impl::setOta(impl::OTA_FAILED, 0, t);
  }
}

void begin() {
  impl::server.collectHeaders(impl::COLLECT_HEADERS, sizeof impl::COLLECT_HEADERS / sizeof impl::COLLECT_HEADERS[0]);
  impl::server.on("/", HTTP_GET, impl::handleRoot);
  impl::server.on("/api/status", HTTP_GET, impl::handleStatus);
  impl::server.on("/api/config", HTTP_GET, impl::handleConfig);
  impl::server.on("/api/ping", HTTP_GET, impl::handlePing);
  impl::server.on("/api/settings", HTTP_POST, impl::handleSettings);
  impl::server.on("/api/action", HTTP_POST, impl::handleAction);
  impl::server.on("/api/update", HTTP_POST, impl::handleUploadDone, impl::handleUploadChunk);
  impl::server.onNotFound([] { impl::sendError(404, "not found"); });
  impl::server.begin();
}

void loop() {
  impl::server.handleClient();
  if (impl::rebootPending_ && (int32_t)(millis() - impl::rebootAtMs_) >= 0) {
    Serial.println("Restarting");
    delay(RESTART_FLUSH_MS);
    ESP.restart();
  }
}

uint32_t statusServed() { return impl::statusServed_; }

void setLoad(uint32_t isrPerSec, uint32_t loopMaxUs) {
  impl::isrPerSec_ = isrPerSec;
  impl::loopMaxUs_ = loopMaxUs;
}

}  // namespace webui

// ============================================================================ SETUP / LOOP

namespace {

// Strict primary with failover, replacing both the old kick-when-quiet watchdog and lwIP's
// round-robin. Exactly one server is installed at a time, so this is the whole selection
// policy. Silence is judged on the global last-sync age, which is sound here precisely because
// only one server is ever installed: any sync in the window came from the active one.
void ntpPolicy() {
  // Cheapest possible test first, ahead of anything that locks. See NTP_POLICY_PERIOD_MS.
  const uint32_t now = millis();
  static uint32_t lastCheckMs = 0;
  if (now - lastCheckMs < NTP_POLICY_PERIOD_MS) return;
  lastCheckMs = now;

  if (!WiFi.isConnected()) return;                 // a dead link is not the server's fault

  uint32_t windowS = timekeeping::syncIntervalS() * NTP_FAILOVER_AFTER_MULT;
  if (windowS < NTP_FAILOVER_MIN_S) windowS = NTP_FAILOVER_MIN_S;

  const uint32_t sinceSwitch = now - timekeeping::slotSinceMs();
  const uint8_t  slot = timekeeping::activeSlot();

  // Has the CURRENT server answered at all? selectSlot restarts SNTP, which sends a request
  // immediately, so a reachable server answers within seconds. Counting syncs since the switch
  // is unambiguous where the global age is not: the age may still be small because the
  // PREVIOUS server answered a moment before the switch.
  const bool answered = timekeeping::syncCount() > timekeeping::slotSyncCount();

  if (!answered) {
    if (sinceSwitch < NTP_PROBE_S * 1000UL) return;            // still inside its grace period
    const uint8_t next = timekeeping::nextUsableSlot(slot);
    Serial.printf("[ntp] %s did not answer in %lus, %s\n", timekeeping::server(),
                  (unsigned long)NTP_PROBE_S,
                  next == slot ? "restarting the request" : "trying the next server");
    timekeeping::selectSlot(next);
    return;
  }

  const int64_t age = timekeeping::lastSyncAgeUs();
  const bool healthy = age >= 0 && age <= (int64_t)windowS * 1000000LL;

  if (healthy) {
    // On a fallback and the primary has had long enough to recover: give it the slot back. If
    // it is still down this costs one poll and the next pass demotes again.
    if (slot != 0 && g_settings.ntpFailover &&
        sinceSwitch >= NTP_RETURN_PRIMARY_S * 1000UL) {
      Serial.println("[ntp] returning to the primary server");
      timekeeping::selectSlot(0);
    }
    return;
  }

  const uint8_t next = timekeeping::nextUsableSlot(slot);
  Serial.printf("[ntp] %s silent for %lus, %s\n", timekeeping::server(),
                (unsigned long)windowS,
                next == slot ? "restarting the request" : "failing over");
  timekeeping::selectSlot(next);
}

}  // namespace

void setup() {
#if ARDUINO_USB_CDC_ON_BOOT
  Serial.setTxTimeoutMs(0);                         // never stall when no USB host is reading
#endif
  Serial.begin(115200);
  panel::begin();                                   // blank the drivers before anything else runs
  Serial.println();
  Serial.println("HU058NtpClock " FW_VERSION " starting");
  g_resetReason = esp_reset_reason();
  {
    // Boot counter in its own namespace, so a factory reset does not clear it.
    Preferences p;
    panel::pauseForFlash();
    if (p.begin("hu058sys", false)) {
      g_bootCount = p.getULong("boots", 0) + 1;
      p.putULong("boots", g_bootCount);
      p.end();
    }
    panel::resumeAfterFlash();
  }
  Serial.printf("Last reset: %s (code %d) | boot #%lu\n",
                resetReasonName(g_resetReason), (int)g_resetReason, (unsigned long)g_bootCount);

  webui::loadOta();
  settings::load();
  // Pin the name and passwords in NVS on the first boot of a build that stores them, so a later
  // build with different defaults can never rename this clock or change its passwords.
  if (!settings::pinned()) settings::save();
  Serial.printf("Hostname %s\n", g_settings.hostname);
  netcfg::begin();
  char activeTz[64];
  settings::effectiveTz(activeTz, sizeof activeTz);
  Serial.printf("NTP %s every %lu s | TZ %s -> %s\n", g_settings.ntpServer,
                (unsigned long)g_settings.syncIntervalS, g_settings.tz, activeTz);

  face::initDutyTable();                            // colour lookup table, replaces powf per frame
  timekeeping::begin(g_settings.ntpServer, activeTz, g_settings.syncIntervalS);
  clockface::settingsChanged();
  buttons::begin();
  wifimgr::begin();
  webui::begin();
}

void loop() {
  const uint32_t passStart = micros();
  wifimgr::loop();

  if (wifimgr::takeGotIp()) {
    // Re-anchor on the primary: a reconnect is a new network situation, and whatever drove
    // the device onto a fallback may well have been the link itself.
    // mDNS first: a .local NTP server can only be resolved once the responder is running.
    services::onGotIp();
    timekeeping::selectSlot(0);             // immediate NTP request on every (re)connect
    netcfg::rememberIfNew();
    Serial.printf("Wi-Fi up: http://%s/  (http://%s.local/)\n",
                  WiFi.localIP().toString().c_str(), g_settings.hostname);
  }

  ntpPolicy();
  services::loop();
  buttons::loop();
  clockface::loop();
  webui::loop();
  settings::loop();

  // Load figures for the System tab: interrupts per second, and the longest single pass of this
  // loop over the last 10 s.
  const uint32_t pass = micros() - passStart;
  static uint32_t windowMax = 0, windowStartMs = 0, lastIsr = 0, lastIsrMs = 0, loopMax = 0, isrRate = 0;
  if (pass > windowMax) windowMax = pass;
  const uint32_t nowMs = millis();
  if (nowMs - lastIsrMs >= LOAD_RATE_PERIOD_MS) {
    const uint32_t c = panel::isrCount();
    isrRate = (uint32_t)((uint64_t)(c - lastIsr) * 1000ULL / (nowMs - lastIsrMs));
    lastIsr = c;
    lastIsrMs = nowMs;
    webui::setLoad(isrRate, loopMax);
  }
  if (nowMs - windowStartMs >= LOOP_MAX_WINDOW_MS) {
    loopMax = windowMax;
    windowMax = 0;
    windowStartMs = nowMs;
  }

  // Heartbeat: a repeating startup banner with "up" resetting means the ESP32 is rebooting;
  // "served" stuck at 0 while the web page is open means the status handler is faulting.
  static uint32_t hbMs = 0;
  if (nowMs - hbMs >= HEARTBEAT_PERIOD_MS) {
    hbMs = nowMs;
    Serial.printf("[hb] up %lus heap %u largest %u min %u wifi %s served %lu isr %lu/s steps %u early %lu late %lu loop max %lu us\n",
                  (unsigned long)(nowMs / 1000), (unsigned)ESP.getFreeHeap(),
                  (unsigned)heap_caps_get_largest_free_block(MALLOC_CAP_8BIT),
                  (unsigned)ESP.getMinFreeHeap(),
                  WiFi.isConnected() ? "up" : "down", (unsigned long)webui::statusServed(),
                  (unsigned long)isrRate, (unsigned)panel::steps(), (unsigned long)panel::earlyCount(),
                  (unsigned long)panel::lateCount(), (unsigned long)loopMax);
  }
  delay(LOOP_IDLE_MS);
}
